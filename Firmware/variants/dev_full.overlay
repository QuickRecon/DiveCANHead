/*
 * Device-tree overlay for the "dev_full" variant.
 *
 * The base divecan_jr.dts declares two ADS1115 ADCs on I2C1 and three
 * USARTs (one per oxygen cell). In the dev_full variant we only need
 * the peripherals that the active cell-type Kconfig selects:
 *
 *   Cell 1 = DiveO2  → USART1 only
 *   Cell 2 = O2S     → USART2 only
 *   Cell 3 = analog  → ADS1115 @ 0x49 (adc_ext2) only
 *
 * Without this overlay the unused nodes still get their Zephyr driver
 * data structs allocated at link time (1,472 B per ADS1115 instance,
 * 354 B per USART), eating RAM for hardware that's compiled in but
 * never spoken to. Setting status = "disabled" on the unused nodes
 * elides the driver's DEVICE_DT_INST_DEFINE for those instances, so
 * the data struct is never emitted.
 *
 * If the variant's Kconfig changes to use a different cell mix (e.g.
 * Cell 1 -> analog, or Cell 3 -> O2S), update this overlay to match
 * or the build will fail with a missing DT-node reference from the
 * cell driver.
 */

/* Second ADS1115 is unused — Cell 3 analog maps to adc_ext2 only. */
&adc_ext1 {
    status = "disabled";
};

/* Cell 3 is analog (over I2C, not UART) so USART3 is unused. */
&usart3 {
    status = "disabled";
};
