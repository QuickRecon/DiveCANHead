/*
 * Layer ON TOP of AP_Aren.overlay.
 *
 * JR+ Rev2 wiring: USART2 and USART3 have TX/RX swapped (ADVFEATURE_SWAP_ENABLE
 * in the Rev2 .ioc) relative to the default pinctrl; USART1 is NOT swapped.
 * Confirmed empirically on the rig 2026-06-23: cell1 (USART1, no swap) polls
 * its CellSim fine (req_count saturates), while cell2/cell3 (USART2/3) get
 * req_count=0 until their TX/RX is swapped.
 *
 * This should ultimately move into boards/quickrecon/divecan_jr/divecan_jr.dts
 * (the board's real wiring), not a variant overlay.
 */

&usart2 {
	tx-rx-swap;
};

&usart3 {
	tx-rx-swap;
};
