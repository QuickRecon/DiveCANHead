## Firmware/tests/solenoid_current/testcase.yaml
```yaml
tests:
  solenoid.current:
    platform_allow: native_sim
    tags: solenoid current
```

## Firmware/tests/solenoid_driver/testcase.yaml
```yaml
tests:
  drivers.solenoid.driver:
    platform_allow: native_sim
    tags: solenoid drivers
```

## Firmware/tests/tank_pressure_io/testcase.yaml
```yaml
tests:
  divecan.tank_pressure_io:
    platform_allow:
      - native_sim
      - native_sim/native/64
    tags:
      - tank_pressure
      - adc
      - unit
```

## Firmware/tests/tank_pressure_math/testcase.yaml
```yaml
tests:
  tank_pressure.math:
    platform_allow: native_sim
    tags: tank_pressure
```
