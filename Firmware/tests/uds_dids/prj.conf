## CMakeLists.txt
```
cmake_minimum_required(VERSION 3.20.0)

# Wrap MCUBoot, flash-area, reboot, and ISO-TP send symbols so the write-DID
# handlers in uds.c can be exercised against a controlled fixture. Must be
# set BEFORE find_package(Zephyr) so they apply to the final executable
# link, not just the `app` static library.
add_link_options(
    -Wl,--wrap=boot_read_bank_header
    -Wl,--wrap=boot_request_upgrade
    -Wl,--wrap=boot_is_img_confirmed
    -Wl,--wrap=flash_area_open
    -Wl,--wrap=flash_area_erase
    -Wl,--wrap=flash_area_close
    -Wl,--wrap=sys_reboot
    -Wl,--wrap=ISOTP_Send
)

find_package(Zephyr REQUIRED HINTS $ENV{ZEPHYR_BASE})
project(test_uds_dids)

set(APP_SRC ${CMAKE_CURRENT_SOURCE_DIR}/../../src)

target_sources(app PRIVATE
    src/main.c
    ${APP_SRC}/divecan/uds/uds.c
    ${APP_SRC}/external_flash.c
    ${APP_SRC}/divecan/divecan_channels.c
    ${APP_SRC}/errors.c
)
# uds_ota.c, uds_settings.c, uds_state_did.c, uds_log_download.c and the
# solenoid/flash-log drivers are deliberately excluded — this module targets
# the DID dispatch + write-handler layer of uds.c itself. Stubs for every
# symbol uds.c references from those modules live in main.c.

target_include_directories(app PRIVATE
    # Test-local include shadow MUST come first — overrides the production
    # solenoid_roles.h whose SOL_DEVICE macro depends on a DT node that
    # doesn't exist on native_sim.
    ${CMAKE_CURRENT_SOURCE_DIR}/include
    ${APP_SRC}/divecan/include
    ${APP_SRC}
    ${CMAKE_CURRENT_SOURCE_DIR}/../../include
)

# Unlike tests/uds_ota (which builds uds.c with the log/solenoid/DiveO2
# sections compiled OUT), this module forces the production feature gates ON
# so the CONFIG_FLASH_LOG / CONFIG_HAS_O2_SOLENOID / CONFIG_HAS_DIVEO2_CELL
# handler blocks (0xF242/0xF243/0xF282-0xF284/0xF4x0D and the log-download
# routing) are compiled and covered.
target_compile_definitions(app PRIVATE
    CONFIG_FLASH_LOG=1
    CONFIG_HAS_O2_SOLENOID=1
    CONFIG_HAS_DIVEO2_CELL=1
)

# glibc gates strnlen() etc. behind _POSIX_C_SOURCE on the native_sim host
# build — the production STM32 picolibc exposes them unconditionally.
target_compile_definitions(app PRIVATE _POSIX_C_SOURCE=200809L)
```

## prj.conf
```kconfig
CONFIG_ZTEST=y
CONFIG_LOG=y
CONFIG_ZBUS=y

# uds.c uses k_uptime_get_32. sys_reboot is wrapped but the header
# requires CONFIG_REBOOT for the prototype to be visible.
CONFIG_REBOOT=y

# Same rationale as tests/uds_ota: we deliberately do NOT enable
# BOOTLOADER_MCUBOOT — it y-selects USE_DT_CODE_PARTITION which doesn't
# apply to native_sim. All boot_* and flash_area_* symbols are wrapped,
# so we never reach the real implementations. The headers we need are
# always available.
CONFIG_FLASH=y
CONFIG_FLASH_MAP=y

# 1 ms tick resolution. The dive-gate tests claim the pressure channel and
# release it 15 ms later so it sits between uds.c's two 10 ms zbus reads
# (session maintenance vs handler gate). native_sim's default 100 Hz tick
# quantizes the 10 ms read timeout and the 15 ms release to the same 20 ms
# boundary, making the outcome tick-order dependent.
CONFIG_SYS_CLOCK_TICKS_PER_SEC=1000
```

## include/solenoid_roles.h
```c
/*
 * Test-local shadow for uds.c's solenoid-role include. The production
 * header's SOL_DEVICE macro expands to DEVICE_DT_GET(DT_NODELABEL(solenoids))
 * which fails to compile on native_sim. This shim defines SOL_DEVICE as NULL
 * and re-declares the two solenoid driver calls uds.c makes; the test main.c
 * provides recording stub bodies for them.
 */
#ifndef TEST_SOLENOID_ROLES_H
#define TEST_SOLENOID_ROLES_H

#include <zephyr/device.h>
#include "common.h"

#define SOL_DEVICE NULL

int solenoid_fire(const struct device *dev, uint8_t channel,
                  uint32_t duration_us);
uint8_t solenoid_channel_count(const struct device *dev);

#endif /* TEST_SOLENOID_ROLES_H */
```
