## CMakeLists.txt
```
cmake_minimum_required(VERSION 3.20.0)

# Include the app tree as a DTS_ROOT so dts/bindings/vendor-prefixes.txt
# (registering the 'test' stub vendor prefix) is picked up.
set(DTS_ROOT ${CMAKE_CURRENT_SOURCE_DIR}/../..)
find_package(Zephyr REQUIRED HINTS $ENV{ZEPHYR_BASE})
project(test_parsers)

# We compile only the parse-function source files, not the full cell modules
# (which have K_THREAD_DEFINE and hardware dependencies). The parse functions
# call OP_ERROR macros, so we need zbus + errors infrastructure.
target_sources(app PRIVATE
    src/test_diveo2.c
    src/test_o2s.c
    ${CMAKE_CURRENT_SOURCE_DIR}/../../src/oxygen_cell_diveo2.c
    ${CMAKE_CURRENT_SOURCE_DIR}/../../src/oxygen_cell_o2s.c
    ${CMAKE_CURRENT_SOURCE_DIR}/../../src/oxygen_cell_channels.c
    ${CMAKE_CURRENT_SOURCE_DIR}/../../src/heartbeat.c
    ${CMAKE_CURRENT_SOURCE_DIR}/../../src/errors.c
)
target_include_directories(app PRIVATE
    ${CMAKE_CURRENT_SOURCE_DIR}/../../include
)
```

## prj.conf
```kconfig
CONFIG_ZTEST=y
CONFIG_LOG=y
CONFIG_ZBUS=y
CONFIG_ZBUS_MSG_SUBSCRIBER=y
CONFIG_REBOOT=y
```

## boards/native_sim.overlay
```dts
/ {
	/* Stub power node — exists only so DT_NODELABEL(power) resolves to a
	 * real DT ordinal, which lets POWER_DEVICE = DEVICE_DT_GET(NODELABEL(power))
	 * expand to a syntactically-valid C identifier (`__device_dts_ord_<N>`).
	 *
	 * The cell modules that the parsers test pulls in (oxygen_cell_diveo2.c,
	 * oxygen_cell_o2s.c) reference POWER_DEVICE inside their thread bodies.
	 * Without this overlay, DT_NODELABEL(power) expands to garbage that
	 * fails C tokenisation. With it, the symbol is undefined but the linker
	 * eliminates the never-started thread function, so the unresolved
	 * reference is dead-code-stripped.
	 *
	 * The compatible string is intentionally one we don't ship a binding
	 * for — keeps the production power_management.c driver from binding to
	 * this stub. Zephyr just warns "unknown compatible" in the DT pass and
	 * moves on, which is exactly what we want.
	 *
	 * If a future parsers test ever needs to call the cell-thread bodies,
	 * this stub will need to grow into a real device with a stub driver
	 * that provides power_get_vbus_voltage(); see git history for an
	 * earlier attempt at that approach.
	 */
	power: stub-power {
		compatible = "test,parsers-stub-power";
		status = "okay";
	};
};
```

## src/test_diveo2.c
```c
/**
 * @file test_diveo2.c
 * @brief DiveO2 digital oxygen sensor parser unit tests
 *
 * Pure host build — no Zephyr threads or hardware. Tests the UART message
 * parsing helpers inside oxygen_cell_diveo2.c. DiveO2 communicates over UART
 * using ASCII messages with the commands #DOXY (simple: ppo2 + temperature +
 * error code) and #DRAW (detailed: adds phase, intensity, pressure, humidity).
 * Error codes are bitmasks that map to CELL_OK, CELL_DEGRADED, or CELL_FAIL.
 * Ported from STM32/Tests/DiveO2_tests.cpp.
 */

#include <zephyr/ztest.h>
#include <string.h>
#include "oxygen_cell_types.h"

/* Mirror of the internal aggregate used by diveo2_parse_detailed_response.
 * Layout must match oxygen_cell_diveo2.c.
 */
typedef struct {
    int32_t raw_ppo2_millihpa;
    int32_t temperature_mc;
    int32_t err_code;
    int32_t phase_mdeg;
    int32_t signal_intensity_uv;
    int32_t ambient_light_uv;
    int32_t ambient_pressure_ubar;
    int32_t housing_humidity_mpercent_rh;
    CellStatus_t status;
} DiveO2DetailedReading_t;

/* Extern declarations for parse functions in oxygen_cell_diveo2.c */
extern CellStatus_t diveo2_parse_error_code(const char *err_str);
extern size_t diveo2_prepare_message_buffer(const char *rawBuffer,
                                            char *outBuffer,
                                            size_t outBufferLen);
extern bool diveo2_parse_simple_response(const char *message,
                                         int32_t *raw_ppo2_millihpa,
                                         int32_t *temperature_mc,
                                         CellStatus_t *status);
extern bool diveo2_parse_detailed_response(const char *message,
                                           DiveO2DetailedReading_t *out);
extern void diveo2_format_tx_command(const char *command, uint8_t *txBuf,
                                     size_t bufLen);
extern CellProtocol_t diveo2_detect_protocol(const char *message);

#define DIVEO2_RX_BUF_LEN 86U
#define DIVEO2_TX_BUF_LEN 8U

/* ============================================================================
 * Error Code Parsing
 * ============================================================================ */

/** @brief Suite: DiveO2 error bitmask → CellStatus_t mapping (diveo2_parse_error_code). */
ZTEST_SUITE(diveo2_error, NULL, NULL, NULL, NULL, NULL);

/** @brief Error code "0" (no bits set) maps to CELL_OK. */
ZTEST(diveo2_error, test_zero_returns_ok)
{
    zassert_equal(CELL_OK, diveo2_parse_error_code("0"));
}

/** @brief ERR_LOW_INTENSITY (bit 1) maps to CELL_FAIL. */
ZTEST(diveo2_error, test_low_intensity_fails)
{
    zassert_equal(CELL_FAIL, diveo2_parse_error_code("2"));
}

/** @brief ERR_HIGH_SIGNAL (bit 2) maps to CELL_FAIL. */
ZTEST(diveo2_error, test_high_signal_fails)
{
    zassert_equal(CELL_FAIL, diveo2_parse_error_code("4"));
}

/** @brief ERR_LOW_SIGNAL (bit 3) maps to CELL_FAIL. */
ZTEST(diveo2_error, test_low_signal_fails)
{
    zassert_equal(CELL_FAIL, diveo2_parse_error_code("8"));
}

/** @brief ERR_HIGH_REF (bit 4) maps to CELL_FAIL. */
ZTEST(diveo2_error, test_high_ref_fails)
{
    zassert_equal(CELL_FAIL, diveo2_parse_error_code("16"));
}

/** @brief ERR_TEMPERATURE (bit 5) maps to CELL_FAIL. */
ZTEST(diveo2_error, test_temp_error_fails)
{
    zassert_equal(CELL_FAIL, diveo2_parse_error_code("32"));
}

/** @brief WARN_HUMIDITY_HIGH (bit 6) maps to CELL_DEGRADED, not CELL_FAIL. */
ZTEST(diveo2_error, test_humidity_high_degraded)
{
    zassert_equal(CELL_DEGRADED, diveo2_parse_error_code("64"));
}

/** @brief WARN_PRESSURE (bit 7) maps to CELL_DEGRADED. */
ZTEST(diveo2_error, test_pressure_warn_degraded)
{
    zassert_equal(CELL_DEGRADED, diveo2_parse_error_code("128"));
}

/** @brief WARN_HUMIDITY_FAIL (bit 8) maps to CELL_DEGRADED. */
ZTEST(diveo2_error, test_humidity_fail_degraded)
{
    zassert_equal(CELL_DEGRADED, diveo2_parse_error_code("256"));
}

/** @brief WARN_NEAR_SATURATION (bit 0) maps to CELL_DEGRADED. */
ZTEST(diveo2_error, test_near_sat_degraded)
{
    zassert_equal(CELL_DEGRADED, diveo2_parse_error_code("1"));
}

/** @brief Multiple fatal bits (ERR_LOW_INTENSITY | ERR_HIGH_SIGNAL) still maps to CELL_FAIL. */
ZTEST(diveo2_error, test_multiple_fatal)
{
    /* ERR_LOW_INTENSITY | ERR_HIGH_SIGNAL = 6 */
    zassert_equal(CELL_FAIL, diveo2_parse_error_code("6"));
}

/** @brief A fatal bit combined with a warning bit yields CELL_FAIL, not CELL_DEGRADED. */
ZTEST(diveo2_error, test_fatal_overrides_warning)
{
    /* ERR_LOW_INTENSITY | WARN_HUMIDITY_HIGH = 66 */
    zassert_equal(CELL_FAIL, diveo2_parse_error_code("66"));
}

/** @brief An unrecognised error bit (0x200) maps to CELL_FAIL as a safe default. */
ZTEST(diveo2_error, test_unknown_error_fails)
{
    /* 0x200 is not a defined error code */
    zassert_equal(CELL_FAIL, diveo2_parse_error_code("512"));
}

/** @brief NULL pointer returns CELL_FAIL without crashing. */
ZTEST(diveo2_error, test_null_fails)
{
    zassert_equal(CELL_FAIL, diveo2_parse_error_code(NULL));
}

/** @brief Empty string (strtol returns 0) maps to CELL_OK — same as code "0". */
ZTEST(diveo2_error, test_empty_string_ok)
{
    zassert_equal(CELL_OK, diveo2_parse_error_code(""));
}

/* ============================================================================
 * Buffer Preparation
 * ============================================================================ */

/** @brief Suite: raw UART buffer → clean ASCII message preparation (diveo2_prepare_message_buffer). */
ZTEST_SUITE(diveo2_buffer, NULL, NULL, NULL, NULL, NULL);

/** @brief A clean message with CRLF terminator is copied verbatim (without CRLF). */
ZTEST(diveo2_buffer, test_normal_copy)
{
    char out[DIVEO2_RX_BUF_LEN];
    size_t skipped = diveo2_prepare_message_buffer(
        "#DOXY 12340 2500 0\r\n", out, sizeof(out));

    zassert_equal(0U, skipped);
    zassert_str_equal("#DOXY 12340 2500 0", out);
}

/** @brief Leading null bytes (UART DMA artefacts) are skipped; skipped count is returned. */
ZTEST(diveo2_buffer, test_skips_leading_nulls)
{
    char raw[64] = {0};

    (void)strcpy(&raw[3], "#DOXY 12340 2500 0\r\n");

    char out[DIVEO2_RX_BUF_LEN];
    size_t skipped = diveo2_prepare_message_buffer(raw, out, sizeof(out));

    zassert_equal(3U, skipped);
    zassert_str_equal("#DOXY 12340 2500 0", out);
}

/** @brief Leading CR bytes are also skipped before copying the message body. */
ZTEST(diveo2_buffer, test_skips_leading_cr)
{
    char out[DIVEO2_RX_BUF_LEN];
    size_t skipped = diveo2_prepare_message_buffer(
        "\r\r\r#DOXY 12340 2500 0\r\n", out, sizeof(out));

    zassert_equal(3U, skipped);
    zassert_str_equal("#DOXY 12340 2500 0", out);
}

/** @brief Copy stops at the first LF; any trailing garbage after CRLF is discarded. */
ZTEST(diveo2_buffer, test_terminates_at_newline)
{
    char out[DIVEO2_RX_BUF_LEN];

    (void)diveo2_prepare_message_buffer(
        "#DOXY 12340 2500 0\r\ngarbage", out, sizeof(out));
    zassert_str_equal("#DOXY 12340 2500 0", out);
}

/** @brief Output is always NUL-terminated even when the buffer is smaller than the input. */
ZTEST(diveo2_buffer, test_always_null_terminated)
{
    char out[DIVEO2_RX_BUF_LEN];

    (void)diveo2_prepare_message_buffer("#DOXY 12340 2500 0", out, 10);
    zassert_equal('\0', out[9]);
}

/** @brief NULL input produces an empty output string without crashing. */
ZTEST(diveo2_buffer, test_null_input)
{
    char out[DIVEO2_RX_BUF_LEN];

    (void)diveo2_prepare_message_buffer(NULL, out, sizeof(out));
    zassert_str_equal("", out);
}

/** @brief NULL output pointer is handled gracefully (no crash). */
ZTEST(diveo2_buffer, test_null_output)
{
    (void)diveo2_prepare_message_buffer("#DOXY 12340 2500 0", NULL, 10);
}

/** @brief Zero output buffer length is handled gracefully (no write, no crash). */
ZTEST(diveo2_buffer, test_zero_length)
{
    char out[DIVEO2_RX_BUF_LEN];

    (void)diveo2_prepare_message_buffer("#DOXY 12340 2500 0", out, 0);
}

/* ============================================================================
 * Simple Response Parsing (#DOXY)
 * ============================================================================ */

/** @brief Suite: simple "#DOXY ppo2 temperature errcode" response parsing (diveo2_parse_simple_response). */
ZTEST_SUITE(diveo2_simple, NULL, NULL, NULL, NULL, NULL);

/** @brief Valid #DOXY message is parsed and PPO2, temperature, and CELL_OK status are populated. */
ZTEST(diveo2_simple, test_valid_message)
{
    int32_t raw_ppo2_millihpa, temp_mc;
    CellStatus_t status;

    zassert_true(diveo2_parse_simple_response(
        "#DOXY 12340 2500 0", &raw_ppo2_millihpa, &temp_mc, &status));
    zassert_equal(12340, raw_ppo2_millihpa);
    zassert_equal(2500, temp_mc);
    zassert_equal(CELL_OK, status);
}

/** @brief Non-zero error code in the message is parsed and reflected in the returned status. */
ZTEST(diveo2_simple, test_error_code)
{
    int32_t raw_ppo2_millihpa, temp_mc;
    CellStatus_t status;

    zassert_true(diveo2_parse_simple_response(
        "#DOXY 10000 2300 2", &raw_ppo2_millihpa, &temp_mc, &status));
    zassert_equal(CELL_FAIL, status);
}

/** @brief A message missing the error-code field returns false (parse failed). */
ZTEST(diveo2_simple, test_missing_field)
{
    int32_t raw_ppo2_millihpa, temp_mc;
    CellStatus_t status;

    zassert_false(diveo2_parse_simple_response(
        "#DOXY 12340 2500", &raw_ppo2_millihpa, &temp_mc, &status));
}

/** @brief A #DRAW message is rejected by the simple parser (wrong command prefix). */
ZTEST(diveo2_simple, test_wrong_command)
{
    int32_t raw_ppo2_millihpa, temp_mc;
    CellStatus_t status;

    zassert_false(diveo2_parse_simple_response(
        "#DRAW 12340 2500 0", &raw_ppo2_millihpa, &temp_mc, &status));
}

/** @brief Empty string returns false without crashing. */
ZTEST(diveo2_simple, test_empty_message)
{
    int32_t raw_ppo2_millihpa, temp_mc;
    CellStatus_t status;

    zassert_false(diveo2_parse_simple_response(
        "", &raw_ppo2_millihpa, &temp_mc, &status));
}

/** @brief NULL message pointer returns false without crashing. */
ZTEST(diveo2_simple, test_null_message)
{
    int32_t raw_ppo2_millihpa, temp_mc;
    CellStatus_t status;

    zassert_false(diveo2_parse_simple_response(
        NULL, &raw_ppo2_millihpa, &temp_mc, &status));
}

/** @brief NULL ppo2 output pointer returns false without crashing. */
ZTEST(diveo2_simple, test_null_output)
{
    int32_t temp_mc;
    CellStatus_t status;

    zassert_false(diveo2_parse_simple_response(
        "#DOXY 12340 2500 0", NULL, &temp_mc, &status));
}

/** @brief Negative numeric fields (cold temperature, flooded cell) are parsed correctly. */
ZTEST(diveo2_simple, test_negative_values)
{
    int32_t raw_ppo2_millihpa, temp_mc;
    CellStatus_t status;

    zassert_true(diveo2_parse_simple_response(
        "#DOXY -100 -500 0", &raw_ppo2_millihpa, &temp_mc, &status));
    zassert_equal(-100, raw_ppo2_millihpa);
    zassert_equal(-500, temp_mc);
}

/** @brief Very large values (up to INT32_MAX) are parsed without overflow. */
ZTEST(diveo2_simple, test_large_values)
{
    int32_t raw_ppo2_millihpa, temp_mc;
    CellStatus_t status;

    zassert_true(diveo2_parse_simple_response(
        "#DOXY 2147483647 1000000 0", &raw_ppo2_millihpa,
        &temp_mc, &status));
    zassert_equal(2147483647, raw_ppo2_millihpa);
    zassert_equal(1000000, temp_mc);
}

/** @brief A genuine zero PPO2 in a well-formed frame is PRESERVED (not a fault).
 *  This is the anti-regression guard for the fix: a real 0.00 reading must stay
 *  0/CELL_OK, only corrupt frames may become FAIL. */
ZTEST(diveo2_simple, test_zero_ppo2_preserved)
{
    int32_t raw_ppo2_millihpa, temp_mc;
    CellStatus_t status;

    zassert_true(diveo2_parse_simple_response(
        "#DOXY 0 2500 0", &raw_ppo2_millihpa, &temp_mc, &status));
    zassert_equal(0, raw_ppo2_millihpa);
    zassert_equal(CELL_OK, status);
}

/** @brief A non-numeric PPO2 field is REJECTED, not silently read as 0.
 *  Pre-fix, strtol("12x40") returned 0 and the frame parsed as a valid zero. */
ZTEST(diveo2_simple, test_garbage_ppo2_rejected)
{
    int32_t raw_ppo2_millihpa, temp_mc;
    CellStatus_t status;

    zassert_false(diveo2_parse_simple_response(
        "#DOXY 12x40 2500 0", &raw_ppo2_millihpa, &temp_mc, &status));
}

/** @brief A PPO2 field with trailing garbage ("1234abc") is rejected. */
ZTEST(diveo2_simple, test_trailing_garbage_ppo2_rejected)
{
    int32_t raw_ppo2_millihpa, temp_mc;
    CellStatus_t status;

    zassert_false(diveo2_parse_simple_response(
        "#DOXY 1234abc 2500 0", &raw_ppo2_millihpa, &temp_mc, &status));
}

/** @brief A non-numeric error-code field is rejected (would otherwise read 0=OK). */
ZTEST(diveo2_simple, test_garbage_errcode_rejected)
{
    int32_t raw_ppo2_millihpa, temp_mc;
    CellStatus_t status;

    zassert_false(diveo2_parse_simple_response(
        "#DOXY 12340 2500 x", &raw_ppo2_millihpa, &temp_mc, &status));
}

/* ============================================================================
 * Detailed Response Parsing (#DRAW)
 * ============================================================================ */

/** @brief Suite: detailed "#DRAW ppo2 temp err phase intensity ambient pressure humidity" parsing. */
ZTEST_SUITE(diveo2_detailed, NULL, NULL, NULL, NULL, NULL);

/** @brief All 8 fields of a valid #DRAW message are parsed and populated in the output struct. */
ZTEST(diveo2_detailed, test_valid_message)
{
    DiveO2DetailedReading_t r = {0};

    zassert_true(diveo2_parse_detailed_response(
        "#DRAW 12340 2500 0 1000 5000 200 1013250 45000", &r));

    zassert_equal(12340, r.raw_ppo2_millihpa);
    zassert_equal(2500, r.temperature_mc);
    zassert_equal(0, r.err_code);
    zassert_equal(1000, r.phase_mdeg);
    zassert_equal(5000, r.signal_intensity_uv);
    zassert_equal(200, r.ambient_light_uv);
    zassert_equal(1013250, r.ambient_pressure_ubar);
    zassert_equal(45000, r.housing_humidity_mpercent_rh);
    zassert_equal(CELL_OK, r.status);
}

/** @brief A warning error code in #DRAW is reflected as CELL_DEGRADED in the output struct. */
ZTEST(diveo2_detailed, test_error_code)
{
    DiveO2DetailedReading_t r = {0};

    zassert_true(diveo2_parse_detailed_response(
        "#DRAW 10000 2300 64 900 4500 150 1010000 50000", &r));

    zassert_equal(64, r.err_code);
    zassert_equal(CELL_DEGRADED, r.status);
}

/** @brief A #DRAW message with only 7 of 8 required fields returns false. */
ZTEST(diveo2_detailed, test_missing_field)
{
    DiveO2DetailedReading_t r = {0};

    zassert_false(diveo2_parse_detailed_response(
        "#DRAW 12340 2500 0 1000 5000 200 1013250", &r));
}

/** @brief A #DOXY message is rejected by the detailed parser (wrong command). */
ZTEST(diveo2_detailed, test_wrong_command)
{
    DiveO2DetailedReading_t r = {0};

    zassert_false(diveo2_parse_detailed_response(
        "#DOXY 12340 2500 0", &r));
}

/** @brief NULL message pointer returns false without crashing. */
ZTEST(diveo2_detailed, test_null_message)
{
    DiveO2DetailedReading_t r = {0};

    zassert_false(diveo2_parse_detailed_response(NULL, &r));
}

/** @brief NULL output pointer returns false without crashing. */
ZTEST(diveo2_detailed, test_null_output)
{
    zassert_false(diveo2_parse_detailed_response(
        "#DRAW 12340 2500 0 1000 5000 200 1013250 45000", NULL));
}

/** @brief A captured real-world #DRAW response is parsed correctly end-to-end. */
ZTEST(diveo2_detailed, test_real_world_message)
{
    DiveO2DetailedReading_t r = {0};

    zassert_true(diveo2_parse_detailed_response(
        "#DRAW 209800 24500 0 38250 12340 45 1013250 42000", &r));

    zassert_equal(209800, r.raw_ppo2_millihpa);
    zassert_equal(24500, r.temperature_mc);
    zassert_equal(0, r.err_code);
    zassert_equal(38250, r.phase_mdeg);
    zassert_equal(12340, r.signal_intensity_uv);
    zassert_equal(45, r.ambient_light_uv);
    zassert_equal(1013250, r.ambient_pressure_ubar);
    zassert_equal(42000, r.housing_humidity_mpercent_rh);
    zassert_equal(CELL_OK, r.status);
}

/* ============================================================================
 * TX Command Formatting
 * ============================================================================ */

/** @brief Suite: TX command serialisation into a fixed-size UART byte buffer (diveo2_format_tx_command). */
ZTEST_SUITE(diveo2_format, NULL, NULL, NULL, NULL, NULL);

/** @brief "#DOXY" command is written with a 0x0D terminator at the expected offset. */
ZTEST(diveo2_format, test_doxy_command)
{
    uint8_t buf[DIVEO2_TX_BUF_LEN];

    diveo2_format_tx_command("#DOXY", buf, sizeof(buf));
    zassert_equal('#', buf[0]);
    zassert_equal('D', buf[1]);
    zassert_equal('O', buf[2]);
    zassert_equal('X', buf[3]);
    zassert_equal('Y', buf[4]);
    zassert_equal(0x0D, buf[5]);
}

/** @brief "#DRAW" command is written with correct bytes and 0x0D at byte[5]. */
ZTEST(diveo2_format, test_draw_command)
{
    uint8_t buf[DIVEO2_TX_BUF_LEN];

    diveo2_format_tx_command("#DRAW", buf, sizeof(buf));
    zassert_equal('#', buf[0]);
    zassert_equal('R', buf[2]);
    zassert_equal(0x0D, buf[5]);
}

/** @brief Long commands are truncated to fit the buffer; the last byte is always 0x0D. */
ZTEST(diveo2_format, test_truncation)
{
    uint8_t buf[DIVEO2_TX_BUF_LEN];

    diveo2_format_tx_command("#VERYLONGCOMMAND", buf, sizeof(buf));
    zassert_equal('#', buf[0]);
    zassert_equal(0x0D, buf[7]);
}

/** @brief Bytes after the 0x0D terminator are zeroed out (no uncleared garbage). */
ZTEST(diveo2_format, test_buffer_zeroed)
{
    uint8_t buf[DIVEO2_TX_BUF_LEN];

    (void)memset(buf, 0xFF, sizeof(buf));
    diveo2_format_tx_command("#A", buf, sizeof(buf));
    zassert_equal('#', buf[0]);
    zassert_equal('A', buf[1]);
    zassert_equal(0x0D, buf[2]);
    zassert_equal(0x00, buf[3]);
}

/** @brief NULL command leaves the output buffer unchanged (no write). */
ZTEST(diveo2_format, test_null_command)
{
    uint8_t buf[DIVEO2_TX_BUF_LEN];

    (void)memset(buf, 0xAA, sizeof(buf));
    diveo2_format_tx_command(NULL, buf, sizeof(buf));
    zassert_equal(0xAA, buf[0]);
}

/** @brief NULL output buffer is handled gracefully (no crash). */
ZTEST(diveo2_format, test_null_buffer)
{
    diveo2_format_tx_command("#DOXY", NULL, 8);
}

/** @brief Zero buffer length prevents any write and leaves the buffer unchanged. */
ZTEST(diveo2_format, test_zero_length)
{
    uint8_t buf[DIVEO2_TX_BUF_LEN];

    (void)memset(buf, 0xAA, sizeof(buf));
    diveo2_format_tx_command("#DOXY", buf, 0);
    zassert_equal(0xAA, buf[0]);
}

/** @brief A command that exactly fills the buffer has 0x0D as the very last byte. */
ZTEST(diveo2_format, test_exact_fit)
{
    uint8_t buf[8];

    diveo2_format_tx_command("#ABCDEF", buf, 8);
    zassert_equal('#', buf[0]);
    zassert_equal('F', buf[6]);
    zassert_equal(0x0D, buf[7]);
}

/* ============================================================================
 * Pyroscience protocol (M prefix) — same parser must accept #MOXY / #MRAW
 * ============================================================================ */

/** @brief Suite: Pyroscience ('M' prefix) frames share the DiveO2 parsers. */
ZTEST_SUITE(diveo2_pyro, NULL, NULL, NULL, NULL, NULL);

/** @brief A #MOXY simple frame parses identically to #DOXY (only the prefix differs). */
ZTEST(diveo2_pyro, test_moxy_simple)
{
    int32_t raw_ppo2_millihpa, temp_mc;
    CellStatus_t status;

    zassert_true(diveo2_parse_simple_response(
        "#MOXY 12340 2500 0", &raw_ppo2_millihpa, &temp_mc, &status));
    zassert_equal(12340, raw_ppo2_millihpa);
    zassert_equal(2500, temp_mc);
    zassert_equal(CELL_OK, status);
}

/** @brief A #MRAW detailed frame parses all 8 fields like #DRAW. */
ZTEST(diveo2_pyro, test_mraw_detailed)
{
    DiveO2DetailedReading_t r = {0};

    zassert_true(diveo2_parse_detailed_response(
        "#MRAW 12340 2500 0 1000 5000 200 1013250 45000", &r));
    zassert_equal(12340, r.raw_ppo2_millihpa);
    zassert_equal(2500, r.temperature_mc);
    zassert_equal(1000, r.phase_mdeg);
    zassert_equal(45000, r.housing_humidity_mpercent_rh);
    zassert_equal(CELL_OK, r.status);
}

/** @brief The simple parser still rejects a detailed (#MRAW) frame — wrong suffix. */
ZTEST(diveo2_pyro, test_mraw_rejected_by_simple)
{
    int32_t raw_ppo2_millihpa, temp_mc;
    CellStatus_t status;

    zassert_false(diveo2_parse_simple_response(
        "#MRAW 12340 2500 0 1000 5000 200 1013250 45000",
        &raw_ppo2_millihpa, &temp_mc, &status));
}

/** @brief A foreign prefix (#XRAW) is rejected by the detailed parser. */
ZTEST(diveo2_pyro, test_foreign_prefix_rejected)
{
    DiveO2DetailedReading_t r = {0};

    zassert_false(diveo2_parse_detailed_response(
        "#XRAW 12340 2500 0 1000 5000 200 1013250 45000", &r));
}

/** @brief A genuine zero PPO2 in a well-formed detailed frame is preserved. */
ZTEST(diveo2_detailed, test_zero_ppo2_preserved)
{
    DiveO2DetailedReading_t r = {0};

    zassert_true(diveo2_parse_detailed_response(
        "#DRAW 0 2500 0 1000 5000 200 1013250 45000", &r));
    zassert_equal(0, r.raw_ppo2_millihpa);
    zassert_equal(CELL_OK, r.status);
}

/** @brief A non-numeric field anywhere in a detailed frame is rejected, not read as 0. */
ZTEST(diveo2_detailed, test_garbage_field_rejected)
{
    DiveO2DetailedReading_t r = {0};

    zassert_false(diveo2_parse_detailed_response(
        "#DRAW 12340 2500 0 1000 5000 abc 1013250 45000", &r));
}

/** @brief A field with trailing garbage ("12340x") is rejected. */
ZTEST(diveo2_detailed, test_trailing_garbage_rejected)
{
    DiveO2DetailedReading_t r = {0};

    zassert_false(diveo2_parse_detailed_response(
        "#DRAW 12340x 2500 0 1000 5000 200 1013250 45000", &r));
}

/* ============================================================================
 * Protocol auto-detection (diveo2_detect_protocol)
 * ============================================================================ */

/** @brief Suite: classify a cell message's protocol family by its prefix. */
ZTEST_SUITE(diveo2_protocol, NULL, NULL, NULL, NULL, NULL);

/** @brief A '#D...' header classifies as DiveO2 (both simple and detailed). */
ZTEST(diveo2_protocol, test_detect_diveo2)
{
    zassert_equal(CELL_PROTO_DIVEO2, diveo2_detect_protocol("#DRAW 1 2 3 4 5 6 7 8"));
    zassert_equal(CELL_PROTO_DIVEO2, diveo2_detect_protocol("#DOXY 1 2 3"));
}

/** @brief A '#M...' header classifies as Pyroscience. */
ZTEST(diveo2_protocol, test_detect_pyro)
{
    zassert_equal(CELL_PROTO_PYRO, diveo2_detect_protocol("#MRAW 1 2 3 4 5 6 7 8"));
    zassert_equal(CELL_PROTO_PYRO, diveo2_detect_protocol("#MOXY 1 2 3"));
}

/** @brief Junk / error / NULL inputs classify as UNKNOWN. */
ZTEST(diveo2_protocol, test_detect_unknown)
{
    zassert_equal(CELL_PROTO_UNKNOWN, diveo2_detect_protocol("#ERRO -26"));
    zassert_equal(CELL_PROTO_UNKNOWN, diveo2_detect_protocol("garbage"));
    zassert_equal(CELL_PROTO_UNKNOWN, diveo2_detect_protocol(""));
    zassert_equal(CELL_PROTO_UNKNOWN, diveo2_detect_protocol(NULL));
}
```

## src/test_o2s.c
```c
/**
 * @file test_o2s.c
 * @brief OxygenScientific (O2S) digital sensor parser unit tests
 *
 * Pure host build — no Zephyr threads or hardware. Tests the UART message
 * parsing helpers inside oxygen_cell_o2s.c. O2S communicates over UART using
 * short ASCII messages of the form "Mn:value" (normal mode) or "Mm:value"
 * (maximum mode), terminated with LF (0x0A). Ported from
 * STM32/Tests/O2S_tests.cpp.
 */

#include <zephyr/ztest.h>
#include <string.h>
#include "common.h"
#include "oxygen_cell_types.h"

/* Extern declarations for parse functions in oxygen_cell_o2s.c */
extern size_t o2s_prepare_message_buffer(const char *rawBuffer,
                                         char *outBuffer,
                                         size_t outBufferLen);
extern bool o2s_parse_response(const char *message, Numeric_t *ppo2);
extern void o2s_format_tx_command(const char *command, uint8_t *txBuf,
                                  size_t bufLen);

#define O2S_RX_BUF_LEN 10U
#define O2S_TX_BUF_LEN 4U

/* ============================================================================
 * Buffer Preparation
 * ============================================================================ */

/** @brief Suite: raw UART buffer → clean ASCII message preparation (o2s_prepare_message_buffer). */
ZTEST_SUITE(o2s_buffer, NULL, NULL, NULL, NULL, NULL);

/** @brief Clean input is copied verbatim into the output buffer. */
ZTEST(o2s_buffer, test_normal_copy)
{
    char out[O2S_RX_BUF_LEN];
    size_t skipped = o2s_prepare_message_buffer("Mn:0.209", out,
                            sizeof(out));

    zassert_equal(0U, skipped);
    zassert_str_equal("Mn:0.209", out);
}

/** @brief Leading null bytes (UART DMA artefacts) are skipped; count returned. */
ZTEST(o2s_buffer, test_skips_leading_nulls)
{
    char raw[O2S_RX_BUF_LEN] = {0};

    (void)strcpy(&raw[2], "Mn:0.21");

    char out[O2S_RX_BUF_LEN];
    size_t skipped = o2s_prepare_message_buffer(raw, out, sizeof(out));

    zassert_equal(2U, skipped);
    zassert_str_equal("Mn:0.21", out);
}

/** @brief Leading LF bytes (leftover from a previous response) are also skipped. */
ZTEST(o2s_buffer, test_skips_leading_lf)
{
    char out[O2S_RX_BUF_LEN];
    size_t skipped = o2s_prepare_message_buffer("\n\nMn:0.209", out,
                            sizeof(out));

    zassert_equal(2U, skipped);
    zassert_str_equal("Mn:0.209", out);
}

/** @brief Trailing CRLF is stripped from the end of the message body. */
ZTEST(o2s_buffer, test_strips_trailing_crlf)
{
    char out[O2S_RX_BUF_LEN];

    (void)o2s_prepare_message_buffer("Mn:0.209\r\n", out, sizeof(out));
    zassert_str_equal("Mn:0.209", out);
}

/** @brief Output is always NUL-terminated even when truncated to a short buffer. */
ZTEST(o2s_buffer, test_always_null_terminated)
{
    char out[O2S_RX_BUF_LEN];

    (void)o2s_prepare_message_buffer("Mn:0.209999", out, 5);
    zassert_equal('\0', out[4]);
}

/** @brief NULL input produces an empty output string without crashing. */
ZTEST(o2s_buffer, test_null_input)
{
    char out[O2S_RX_BUF_LEN];

    (void)o2s_prepare_message_buffer(NULL, out, sizeof(out));
    zassert_str_equal("", out);
}

/** @brief NULL output pointer is handled gracefully (no crash). */
ZTEST(o2s_buffer, test_null_output)
{
    (void)o2s_prepare_message_buffer("Mn:0.209", NULL, 10);
}

/** @brief Zero output buffer length prevents any write (no crash). */
ZTEST(o2s_buffer, test_zero_length)
{
    char out[O2S_RX_BUF_LEN];

    (void)o2s_prepare_message_buffer("Mn:0.209", out, 0);
}

/** @brief Mixed leading null and LF bytes are all skipped before the message body. */
ZTEST(o2s_buffer, test_mixed_leading_junk)
{
    char raw[O2S_RX_BUF_LEN] = {0};

    raw[0] = '\0';
    raw[1] = '\n';
    raw[2] = '\0';
    (void)strcpy(&raw[3], "Mn:0.5");

    char out[O2S_RX_BUF_LEN];
    size_t skipped = o2s_prepare_message_buffer(raw, out, sizeof(out));

    zassert_equal(3U, skipped);
    zassert_str_equal("Mn:0.5", out);
}

/* ============================================================================
 * Response Parsing
 * ============================================================================ */

/** @brief Suite: "Mx:value" ASCII response parsing → float PPO2 (o2s_parse_response). */
ZTEST_SUITE(o2s_parse, NULL, NULL, NULL, NULL, NULL);

/** @brief "Mn:0.209" normal-mode response is parsed and the float value returned. */
ZTEST(o2s_parse, test_valid_mn_response)
{
    float ppo2;

    zassert_true(o2s_parse_response("Mn:0.209", &ppo2));
    zassert_within(ppo2, 0.209f, 0.001f);
}

/** @brief "Mm:0.95" maximum-mode response is also accepted and parsed. */
ZTEST(o2s_parse, test_valid_mm_response)
{
    float ppo2;

    zassert_true(o2s_parse_response("Mm:0.95", &ppo2));
    zassert_within(ppo2, 0.95f, 0.001f);
}

/** @brief An echo-only message ("Mm:" with no value after the colon) returns false. */
ZTEST(o2s_parse, test_echo_only_false)
{
    float ppo2;

    zassert_false(o2s_parse_response("Mm:", &ppo2));
}

/** @brief A message without a colon (just "Mn") returns false. */
ZTEST(o2s_parse, test_no_colon_false)
{
    float ppo2;

    zassert_false(o2s_parse_response("Mn", &ppo2));
}

/** @brief A message with the value run directly into the command ("Mn0.209") is rejected. */
ZTEST(o2s_parse, test_malformed_no_colon)
{
    float ppo2;

    zassert_false(o2s_parse_response("Mn0.209", &ppo2));
}

/** @brief An unrecognised command prefix ("Mx") returns false. */
ZTEST(o2s_parse, test_unknown_command)
{
    float ppo2;

    zassert_false(o2s_parse_response("Mx:0.209", &ppo2));
}

/** @brief NULL message pointer returns false without crashing. */
ZTEST(o2s_parse, test_null_message)
{
    float ppo2;

    zassert_false(o2s_parse_response(NULL, &ppo2));
}

/** @brief NULL ppo2 output pointer returns false without crashing. */
ZTEST(o2s_parse, test_null_output)
{
    zassert_false(o2s_parse_response("Mn:0.209", NULL));
}

/** @brief Empty string returns false without crashing. */
ZTEST(o2s_parse, test_empty_message)
{
    float ppo2;

    zassert_false(o2s_parse_response("", &ppo2));
}

/** @brief High PPO2 (1.600 bar — deep O2 exposure limit) is parsed without saturation. */
ZTEST(o2s_parse, test_high_ppo2)
{
    float ppo2;

    zassert_true(o2s_parse_response("Mn:1.600", &ppo2));
    zassert_within(ppo2, 1.600f, 0.001f);
}

/** @brief Zero PPO2 is parsed correctly (e.g. cell submerged in nitrogen). */
ZTEST(o2s_parse, test_zero_ppo2)
{
    float ppo2;

    zassert_true(o2s_parse_response("Mn:0.00", &ppo2));
    zassert_within(ppo2, 0.0f, 0.001f);
}

/** @brief Slightly negative float value (sensor noise) is parsed and stored as-is. */
ZTEST(o2s_parse, test_negative_value)
{
    float ppo2;

    zassert_true(o2s_parse_response("Mn:-0.01", &ppo2));
    zassert_within(ppo2, -0.01f, 0.001f);
}

/** @brief A non-numeric value ("Mn:abc") is REJECTED, not silently read as 0.0.
 *  Pre-fix, strtof(NULL) returned 0.0 and the frame latched a bogus zero. */
ZTEST(o2s_parse, test_garbage_value_rejected)
{
    float ppo2;

    zassert_false(o2s_parse_response("Mn:abc", &ppo2));
}

/** @brief A value with trailing garbage ("Mn:1.6x") is rejected. */
ZTEST(o2s_parse, test_trailing_garbage_rejected)
{
    float ppo2;

    zassert_false(o2s_parse_response("Mn:1.6x", &ppo2));
}

/* ============================================================================
 * TX Command Formatting
 * ============================================================================ */

/** @brief Suite: TX command serialisation into a fixed-size UART byte buffer (o2s_format_tx_command). */
ZTEST_SUITE(o2s_format, NULL, NULL, NULL, NULL, NULL);

/** @brief "Mm" command is written with a 0x0A (LF) terminator. */
ZTEST(o2s_format, test_mm_command)
{
    uint8_t buf[O2S_TX_BUF_LEN];

    o2s_format_tx_command("Mm", buf, sizeof(buf));
    zassert_equal('M', buf[0]);
    zassert_equal('m', buf[1]);
    zassert_equal(0x0A, buf[2]);
}

/** @brief Bytes after the LF terminator are zeroed out (no uncleared garbage). */
ZTEST(o2s_format, test_buffer_zeroed)
{
    uint8_t buf[O2S_TX_BUF_LEN];

    (void)memset(buf, 0xFF, sizeof(buf));
    o2s_format_tx_command("M", buf, sizeof(buf));
    zassert_equal('M', buf[0]);
    zassert_equal(0x0A, buf[1]);
    zassert_equal(0x00, buf[2]);
    zassert_equal(0x00, buf[3]);
}

/** @brief Commands longer than the buffer are truncated; last byte is always 0x0A. */
ZTEST(o2s_format, test_truncation)
{
    uint8_t buf[O2S_TX_BUF_LEN];

    o2s_format_tx_command("MmLongCommand", buf, sizeof(buf));
    zassert_equal('M', buf[0]);
    zassert_equal('m', buf[1]);
    zassert_equal('L', buf[2]);
    zassert_equal(0x0A, buf[3]);
}

/** @brief NULL command leaves the buffer unchanged (no write). */
ZTEST(o2s_format, test_null_command)
{
    uint8_t buf[O2S_TX_BUF_LEN];

    (void)memset(buf, 0xAA, sizeof(buf));
    o2s_format_tx_command(NULL, buf, sizeof(buf));
    zassert_equal(0xAA, buf[0]);
}

/** @brief NULL output buffer is handled gracefully (no crash). */
ZTEST(o2s_format, test_null_buffer)
{
    o2s_format_tx_command("Mm", NULL, 4);
}

/** @brief Zero buffer length prevents any write and leaves the buffer unchanged. */
ZTEST(o2s_format, test_zero_length)
{
    uint8_t buf[O2S_TX_BUF_LEN];

    (void)memset(buf, 0xAA, sizeof(buf));
    o2s_format_tx_command("Mm", buf, 0);
    zassert_equal(0xAA, buf[0]);
}

/** @brief A 3-char command in a 4-byte buffer: chars fill [0..2] and 0x0A occupies [3]. */
ZTEST(o2s_format, test_exact_fit)
{
    uint8_t buf[4];

    o2s_format_tx_command("Mmx", buf, 4);
    zassert_equal('M', buf[0]);
    zassert_equal('m', buf[1]);
    zassert_equal('x', buf[2]);
    zassert_equal(0x0A, buf[3]);
}

/** @brief A single-character command is written followed by 0x0A and zeroed trailing bytes. */
ZTEST(o2s_format, test_single_char)
{
    uint8_t buf[O2S_TX_BUF_LEN];

    o2s_format_tx_command("M", buf, sizeof(buf));
    zassert_equal('M', buf[0]);
    zassert_equal(0x0A, buf[1]);
    zassert_equal(0x00, buf[2]);
}
```
