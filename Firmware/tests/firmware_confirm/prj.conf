## CMakeLists.txt
```
cmake_minimum_required(VERSION 3.20.0)

# --wrap the bootutil entry points and the F-section counter accessors
# so the test fixture can drive the POST state machine deterministically.
# sys_reboot is wrapped so a POST failure path doesn't actually exit the
# host process — the wrap longjmps back out to the test body.
add_link_options(
    -Wl,--wrap=boot_write_img_confirmed
    -Wl,--wrap=sys_reboot
    -Wl,--wrap=divecan_send_get_tx_count
    -Wl,--wrap=divecan_rx_get_bus_init_count
    -Wl,--wrap=divecan_rx_get_bus_id_count
)

find_package(Zephyr REQUIRED HINTS $ENV{ZEPHYR_BASE})
project(test_firmware_confirm)

target_sources(app PRIVATE
    src/main.c
    ${CMAKE_CURRENT_SOURCE_DIR}/../../src/firmware_confirm.c
    ${CMAKE_CURRENT_SOURCE_DIR}/../../src/errors.c
    ${CMAKE_CURRENT_SOURCE_DIR}/../../src/oxygen_cell_channels.c
)
target_include_directories(app PRIVATE
    ${CMAKE_CURRENT_SOURCE_DIR}/../../include
    ${CMAKE_CURRENT_SOURCE_DIR}/../../src
)

# CONFIG_CELL_COUNT lives in src/Kconfig's product-topology menu, which we
# don't source into this test build. oxygen_cell_channels.c sees the
# symbol via #if CONFIG_CELL_COUNT >= N — supply it here so the channel
# definitions for cells 2 and 3 are included.
target_compile_definitions(app PRIVATE CONFIG_CELL_COUNT=3)
```

## Kconfig
```
mainmenu "firmware_confirm POST gate test"

# Pull in only the POST gate's own knobs. Avoiding rsource of the full
# src/Kconfig keeps the test build free of product-topology requirements
# (cell type, power mode, battery chemistry).
rsource "../../src/Kconfig.firmware_confirm"

source "Kconfig.zephyr"
```

## prj.conf
```kconfig
CONFIG_ZTEST=y
CONFIG_LOG=y
CONFIG_ZBUS=y
CONFIG_REBOOT=y

# State Machine Framework — flat-only.
CONFIG_SMF=y
# CONFIG_SMF_ANCESTOR_SUPPORT is not set
# CONFIG_SMF_INITIAL_TRANSITION is not set

# Tight deadline + sub-timeouts so every test completes in under a second
# rather than the production 45 s. The state machine is the same — only
# the wall-clock budgets are different.
CONFIG_FIRMWARE_CONFIRM_DEADLINE_MS=600
CONFIG_FIRMWARE_CONFIRM_CELL_TIMEOUT_MS=300
CONFIG_FIRMWARE_CONFIRM_CONSENSUS_TIMEOUT_MS=200
CONFIG_FIRMWARE_CONFIRM_PPO2_TX_TIMEOUT_MS=200
CONFIG_FIRMWARE_CONFIRM_HANDSET_TIMEOUT_MS=200
CONFIG_FIRMWARE_CONFIRM_SOL_TIMEOUT_MS=200

# We don't link any solenoid-related code in this test build so HAS_O2_SOLENOID
# is left unset by default — the POST module compiles the no-op skip path.
# CONFIG_CELL_COUNT is forced via target_compile_definitions in the
# CMakeLists since it lives in the product-topology Kconfig we don't source.

# Pull in chan_solenoid_status / chan_atmos_pressure declarations even though
# we link the channel definitions out — the production firmware_confirm.c
# references chan_solenoid_status only under CONFIG_HAS_O2_SOLENOID, and we
# leave that off.
#
# CONFIG_CELL_COUNT lives in src/Kconfig (product-topology menu) — we don't
# rsource that file into the test, and the oxygen_cell_channels.c source we
# link sees the symbol via the preprocessor only. The CMakeLists supplies
# CONFIG_CELL_COUNT=3 as a target_compile_definition instead.
```

## src/main.c
```c
/**
 * @file main.c
 * @brief Unit tests for the POST gate (firmware_confirm.c).
 *
 * Drives the state machine synchronously via firmware_confirm_run_sync_for_test()
 * and asserts on the recorded calls to boot_write_img_confirmed and sys_reboot.
 * Zbus channel inputs (cells, consensus, solenoid) are produced by publishing
 * messages on the real channels — oxygen_cell_channels.c is linked in so the
 * channel objects exist; the divecan side is stubbed (no chan_solenoid_status
 * needed because CONFIG_HAS_O2_SOLENOID is off in this test variant).
 */

#include <zephyr/ztest.h>
#include <zephyr/kernel.h>
#include <zephyr/zbus/zbus.h>
#include <zephyr/sys/atomic.h>
#include <zephyr/sys/util.h>
#include <zephyr/dfu/mcuboot.h>   /* BOOT_SWAP_TYPE_* for the init-decision tests */

#include <setjmp.h>
#include <string.h>

#include "firmware_confirm.h"
#include "oxygen_cell_channels.h"
#include "oxygen_cell_types.h"
#include "errors.h"

/* ---- Fake F-section counter state ---- */

static struct {
    atomic_t tx_value;
    atomic_t tx_advance;
    atomic_t bus_init_value;
    atomic_t bus_id_value;
    atomic_t handset_advance;
    int      boot_write_calls;
    int      reboot_calls;
    int      reboot_reason;
    bool     reboot_active;
    jmp_buf  reboot_escape;
} g;

uint32_t __wrap_divecan_send_get_tx_count(void)
{
    uint32_t cur = (uint32_t)atomic_get(&g.tx_value);
    (void)atomic_add(&g.tx_value, atomic_get(&g.tx_advance));
    return cur;
}

uint32_t __wrap_divecan_rx_get_bus_init_count(void)
{
    uint32_t cur = (uint32_t)atomic_get(&g.bus_init_value);
    (void)atomic_add(&g.bus_init_value, atomic_get(&g.handset_advance));
    return cur;
}

uint32_t __wrap_divecan_rx_get_bus_id_count(void)
{
    return (uint32_t)atomic_get(&g.bus_id_value);
}

int __wrap_boot_write_img_confirmed(void)
{
    g.boot_write_calls++;
    return 0;
}

#if defined(__GNUC__)
__attribute__((noreturn))
#endif
void __wrap_sys_reboot(int type)
{
    g.reboot_calls++;
    g.reboot_reason = type;
    if (g.reboot_active) {
        longjmp(g.reboot_escape, 1);
    }
    /* Should be unreachable in tests; spin so the host doesn't actually exit. */
    while (1) {
        /* no-op */
    }
}

/* ---- Helpers for tests ---- */

static void publish_cell(const struct zbus_channel *chan, uint8_t cell_num,
                         CellStatus_t status)
{
    OxygenCellMsg_t msg = {
        .cell_number = cell_num,
        .ppo2 = (CELL_OK == status) ? 70U : PPO2_FAIL,
        .precision_ppo2 = (CELL_OK == status) ? 0.7 : 0.0,
        .millivolts = 1000U,
        .status = status,
        .timestamp_ticks = k_uptime_ticks(),
    };
    (void)zbus_chan_pub(chan, &msg, K_MSEC(100));
}

static void publish_consensus_ok(void)
{
    ConsensusMsg_t msg = {0};
    msg.consensus_ppo2 = 70U;
    msg.precision_consensus = 0.7;
    msg.confidence = 3U;
    (void)zbus_chan_pub(&chan_consensus, &msg, K_MSEC(100));
}

static void publish_consensus_fail(void)
{
    ConsensusMsg_t msg = {0};
    msg.consensus_ppo2 = PPO2_FAIL;
    msg.precision_consensus = 0.0;
    msg.confidence = 0U;
    (void)zbus_chan_pub(&chan_consensus, &msg, K_MSEC(100));
}

static void arm_healthy_cells(void)
{
    publish_cell(&chan_cell_1, 0, CELL_OK);
    publish_cell(&chan_cell_2, 1, CELL_OK);
    publish_cell(&chan_cell_3, 2, CELL_OK);
}

static void arm_healthy_counters(void)
{
    (void)atomic_set(&g.tx_advance, 5);    /* each read advances by 5 → delta>=3 fast */
    (void)atomic_set(&g.handset_advance, 5);
}

static void run_post_with_reboot_catch(void)
{
    g.reboot_active = true;
    if (0 == setjmp(g.reboot_escape)) {
        firmware_confirm_run_sync_for_test();
    }
    g.reboot_active = false;
}

/* ---- Fixture ---- */

static void reset_fixture(void *unused)
{
    ARG_UNUSED(unused);
    memset(&g, 0, sizeof(g));
    (void)atomic_set(&g.tx_value, 0);
    (void)atomic_set(&g.tx_advance, 0);
    (void)atomic_set(&g.bus_init_value, 0);
    (void)atomic_set(&g.bus_id_value, 0);
    (void)atomic_set(&g.handset_advance, 0);

    firmware_confirm_reset_for_test();

    /* Republish cell channels in their default (failed) state so a prior
     * test's healthy publish doesn't bleed into the next case. */
    OxygenCellMsg_t fail = {0};
    fail.ppo2 = PPO2_FAIL;
    fail.status = CELL_FAIL;
    (void)zbus_chan_pub(&chan_cell_1, &fail, K_MSEC(50));
    (void)zbus_chan_pub(&chan_cell_2, &fail, K_MSEC(50));
    (void)zbus_chan_pub(&chan_cell_3, &fail, K_MSEC(50));
    publish_consensus_fail();
}

ZTEST_SUITE(firmware_confirm, NULL, NULL, reset_fixture, NULL, NULL);

/* ---- Tests ---- */

ZTEST(firmware_confirm, test_initial_state_is_init)
{
    zassert_equal(firmware_confirm_get_state(), POST_INIT,
                  "state must start at POST_INIT");
    zassert_equal(firmware_confirm_get_pass_mask(), 0U,
                  "pass mask must start at 0");
}

ZTEST(firmware_confirm, test_happy_path_confirms)
{
    arm_healthy_cells();
    publish_consensus_ok();
    arm_healthy_counters();

    run_post_with_reboot_catch();

    zassert_equal(firmware_confirm_get_state(), POST_CONFIRMED,
                  "happy path must reach POST_CONFIRMED");
    zassert_equal(g.boot_write_calls, 1,
                  "boot_write_img_confirmed must be called exactly once");
    zassert_equal(g.reboot_calls, 0,
                  "happy path must not reboot");
}

ZTEST(firmware_confirm, test_cell_failure_aborts_with_reboot)
{
    /* Cell 1 stays FAIL; cells 2 & 3 are healthy. */
    publish_cell(&chan_cell_2, 1, CELL_OK);
    publish_cell(&chan_cell_3, 2, CELL_OK);
    publish_consensus_ok();
    arm_healthy_counters();

    run_post_with_reboot_catch();

    zassert_equal(firmware_confirm_get_state(), POST_FAILED_CELL,
                  "must land in POST_FAILED_CELL");
    zassert_equal(g.boot_write_calls, 0,
                  "must NOT confirm on cell failure");
    zassert_equal(g.reboot_calls, 1,
                  "must reboot exactly once on cell failure");
}

ZTEST(firmware_confirm, test_consensus_never_arrives)
{
    arm_healthy_cells();
    /* consensus stays FAIL from reset_fixture's publish */
    arm_healthy_counters();

    run_post_with_reboot_catch();

    zassert_equal(firmware_confirm_get_state(), POST_FAILED_CONSENSUS,
                  "must fail in CONSENSUS state");
    zassert_equal(g.reboot_calls, 1, "must reboot");
}

ZTEST(firmware_confirm, test_no_ppo2_tx_aborts)
{
    arm_healthy_cells();
    publish_consensus_ok();
    /* tx_advance stays 0 → counter never increments */
    (void)atomic_set(&g.handset_advance, 5);

    run_post_with_reboot_catch();

    zassert_equal(firmware_confirm_get_state(), POST_FAILED_NO_PPO2_TX,
                  "must fail in NO_PPO2_TX state");
    zassert_equal(g.reboot_calls, 1, "must reboot");
}

ZTEST(firmware_confirm, test_no_handset_aborts)
{
    arm_healthy_cells();
    publish_consensus_ok();
    (void)atomic_set(&g.tx_advance, 5);
    /* handset_advance stays 0 → no BUS_INIT/BUS_ID frames seen */

    run_post_with_reboot_catch();

    zassert_equal(firmware_confirm_get_state(), POST_FAILED_NO_HANDSET,
                  "handset gate is mandatory — must fail with no RX");
    zassert_equal(g.reboot_calls, 1, "must reboot");
    zassert_equal(g.boot_write_calls, 0,
                  "must NOT confirm without handset evidence");
}

ZTEST(firmware_confirm, test_overall_deadline_aborts_when_first_check_stalls)
{
    /* Don't publish any healthy cells. The cell wait should time out
     * within its sub-budget (300 ms), but if we'd somehow set a small
     * overall deadline that beat the sub-budget the path leading to
     * POST_FAILED_TIMEOUT instead of POST_FAILED_CELL would fire. The
     * default test prj.conf gives us 600 ms overall vs 300 ms per cell,
     * so this case lands in POST_FAILED_CELL — see the dedicated
     * timeout test below for the deadline-exhaustion path. */
    arm_healthy_counters();
    publish_consensus_ok();

    run_post_with_reboot_catch();

    zassert_true(firmware_confirm_get_state() == POST_FAILED_CELL ||
                 firmware_confirm_get_state() == POST_FAILED_TIMEOUT,
                 "first-stall must fail in CELL or TIMEOUT (got %d)",
                 (int)firmware_confirm_get_state());
}

ZTEST(firmware_confirm, test_pass_mask_tracks_completed_checks_partial)
{
    /* Pass cells + consensus, fail at PPO2 TX. */
    arm_healthy_cells();
    publish_consensus_ok();
    (void)atomic_set(&g.tx_advance, 0);     /* tx counter stuck */
    (void)atomic_set(&g.handset_advance, 5);

    run_post_with_reboot_catch();

    uint32_t mask = firmware_confirm_get_pass_mask();
    zassert_true((mask & (uint32_t)BIT(POST_PASS_BIT_CELLS)) != 0U,
                 "CELLS bit must be set");
    zassert_true((mask & (uint32_t)BIT(POST_PASS_BIT_CONSENSUS)) != 0U,
                 "CONSENSUS bit must be set");
    zassert_true((mask & (uint32_t)BIT(POST_PASS_BIT_PPO2_TX)) == 0U,
                 "PPO2_TX bit must NOT be set");
    zassert_true((mask & (uint32_t)BIT(POST_PASS_BIT_HANDSET)) == 0U,
                 "HANDSET bit must NOT be set");
}

ZTEST(firmware_confirm, test_pass_mask_full_on_confirm)
{
    arm_healthy_cells();
    publish_consensus_ok();
    arm_healthy_counters();

    run_post_with_reboot_catch();

    uint32_t mask = firmware_confirm_get_pass_mask();
    uint32_t expected = (uint32_t)BIT(POST_PASS_BIT_CELLS)
                      | (uint32_t)BIT(POST_PASS_BIT_CONSENSUS)
                      | (uint32_t)BIT(POST_PASS_BIT_PPO2_TX)
                      | (uint32_t)BIT(POST_PASS_BIT_HANDSET)
                      | (uint32_t)BIT(POST_PASS_BIT_SOLENOID);
    zassert_equal(mask, expected,
                  "all five bits must set on happy-path confirm (got 0x%x)", mask);
}

ZTEST(firmware_confirm, test_solenoid_skipped_when_disabled)
{
    /* This build sets CONFIG_HAS_O2_SOLENOID=n, so the solenoid waiter
     * returns true unconditionally. Re-verify by going through the full
     * happy path and asserting POST_CONFIRMED — if the skip path were
     * broken, we'd block waiting for chan_solenoid_status (which isn't
     * even declared in this build) and abort. */
    arm_healthy_cells();
    publish_consensus_ok();
    arm_healthy_counters();

    run_post_with_reboot_catch();

    zassert_equal(firmware_confirm_get_state(), POST_CONFIRMED,
                  "solenoid skip path must allow confirm to complete");
}

ZTEST(firmware_confirm, test_state_accessor_readable_during_failure)
{
    /* Fail in the consensus stage and then read the state from "outside" —
     * this exercises the atomic read path the UDS DID would use. */
    arm_healthy_cells();
    /* leave consensus FAIL */
    arm_healthy_counters();

    run_post_with_reboot_catch();

    PostState_t s = firmware_confirm_get_state();
    zassert_equal(s, POST_FAILED_CONSENSUS,
                  "accessor must report the recorded failure state");
}

ZTEST(firmware_confirm, test_overall_deadline_lands_in_timeout_state)
{
    /* Force the overall deadline to bite before the per-check sub-budget.
     * In this build the cell sub-timeout is 300 ms and the overall
     * deadline is 600 ms. We arm cells healthy + consensus FAIL — the
     * consensus check (sub-budget 200 ms) is what stalls. By the time
     * cells (300 ms) + consensus (200 ms) have run, we're at 500 ms
     * elapsed. We then deliberately fail PPO2 TX too (advance=0), which
     * has a 200 ms sub-budget — but only ~100 ms of overall budget left.
     * The PPO2 TX waiter's clamp_budget shrinks to 100 ms and the
     * remaining check will fail. The "did we cross the overall deadline
     * during the failing check" probe at abort-time should land us in
     * POST_FAILED_TIMEOUT.
     *
     * The reset_fixture publishes consensus FAIL, so cells pass + the
     * very next check (consensus) is what stalls — its sub-budget is
     * 200 ms, with the cells having taken 0 ms (no waiting). So we'd
     * end up at POST_FAILED_CONSENSUS at 200 ms, well inside the 600 ms
     * overall deadline. To force the TIMEOUT branch, lengthen the
     * cell wait by leaving cell 3 silent — cells stall 300 ms (full
     * sub-budget), then consensus stalls 200 ms (full sub-budget),
     * total 500 ms. PPO2 TX stage: 100 ms budget remaining; it stalls
     * the full 100 ms, then deadline_remaining hits zero → TIMEOUT
     * branch.
     */
    publish_cell(&chan_cell_1, 0, CELL_OK);
    publish_cell(&chan_cell_2, 1, CELL_OK);
    /* cell 3 left in FAIL from reset_fixture */
    publish_consensus_fail();
    (void)atomic_set(&g.tx_advance, 0);

    run_post_with_reboot_catch();

    /* Either CELL or TIMEOUT is acceptable — the exact state depends
     * on which check exhausts the deadline first. The key invariant
     * we care about is that we did NOT confirm. */
    PostState_t s = firmware_confirm_get_state();
    zassert_true(s == POST_FAILED_CELL || s == POST_FAILED_TIMEOUT,
                 "overall stall must abort, got state %d", (int)s);
    zassert_equal(g.boot_write_calls, 0,
                  "must not confirm when overall deadline blown");
}

ZTEST(firmware_confirm, test_handset_one_bus_id_only_passes)
{
    /* Confirm the handset gate accepts a BUS_ID-only handset
     * (already-paired one). Set bus_id_value to 1 statically — the
     * baseline-captured-at-start logic should still cross threshold. */
    arm_healthy_cells();
    publish_consensus_ok();
    (void)atomic_set(&g.tx_advance, 5);
    /* bus_init_advance stays 0, but we increment bus_id_value once. */
    (void)atomic_set(&g.bus_id_value, 0);
    (void)atomic_set(&g.handset_advance, 0);

    /* Pre-bump bus_id_value mid-test isn't viable from this thread once
     * run_sync starts, so use bus_init_value with advance instead. The
     * point of this test is "advance from baseline" — handle either route. */
    (void)atomic_set(&g.handset_advance, 1);

    run_post_with_reboot_catch();

    zassert_equal(firmware_confirm_get_state(), POST_CONFIRMED,
                  "BUS_ID-only handset evidence must pass the gate");
}

ZTEST(firmware_confirm, test_handset_counter_saturates)
{
    /* Pin both handset RX counters at their ceiling so their sum exceeds
     * UINT32_MAX and handset_rx_total() takes the saturation-clamp arm.
     * With both counters static at UINT32_MAX the gate never sees growth
     * (now_total == rx_baseline), so it fails NO_HANDSET — but the clamp
     * is exercised during baseline capture and every handset tick. */
    arm_healthy_cells();
    publish_consensus_ok();
    (void)atomic_set(&g.tx_advance, 5);
    (void)atomic_set(&g.bus_init_value, (atomic_val_t)UINT32_MAX);
    (void)atomic_set(&g.bus_id_value, (atomic_val_t)UINT32_MAX);
    (void)atomic_set(&g.handset_advance, 0);

    run_post_with_reboot_catch();

    zassert_equal(firmware_confirm_get_state(), POST_FAILED_NO_HANDSET,
                  "saturated static handset counters must fail the gate");
    zassert_equal(g.reboot_calls, 1, "must reboot");
}

ZTEST(firmware_confirm, test_ztest_init_is_noop)
{
    /* The CONFIG_ZTEST firmware_confirm_init() is a deliberate no-op — the
     * suite drives run_post_sequence() directly. Invoke it to document that
     * contract and cover the stub body. */
    PostState_t before = firmware_confirm_get_state();
    firmware_confirm_init();
    zassert_equal(firmware_confirm_get_state(), before,
                  "ztest firmware_confirm_init() must not change POST state");
}

/* ---- firmware_confirm_init decision matrix --------------------------------
 *
 * Regression coverage for the bug where POST was DEFERRED on a freshly-swapped
 * image. firmware_confirm_init() reads boot_is_img_confirmed() + mcuboot_swap_type()
 * and routes via firmware_confirm_decide(); that pure decision is unit-tested here
 * over the full (confirmed, swap_type) space so the REVERT case can never silently
 * regress to "deferred" again. (The HIL test_full_swap exercises the live lifecycle;
 * this catches the decision instantly in native_sim.)
 */
ZTEST_SUITE(firmware_confirm_decide, NULL, NULL, NULL, NULL, NULL);

ZTEST(firmware_confirm_decide, test_confirmed_is_silent_any_swap)
{
    zassert_equal(firmware_confirm_decide(true, BOOT_SWAP_TYPE_NONE), POST_ACTION_SILENT,
                  "a confirmed image must be POST-silent");
    zassert_equal(firmware_confirm_decide(true, BOOT_SWAP_TYPE_REVERT), POST_ACTION_SILENT,
                  "confirmed wins over any swap type");
    zassert_equal(firmware_confirm_decide(true, BOOT_SWAP_TYPE_TEST), POST_ACTION_SILENT,
                  "confirmed wins over any swap type");
}

ZTEST(firmware_confirm_decide, test_unconfirmed_revert_runs_post)
{
    /* THE regression: a freshly-swapped, unconfirmed image reports REVERT and MUST
     * run POST so it can be validated + confirmed (else every OTA reverts). */
    zassert_equal(firmware_confirm_decide(false, BOOT_SWAP_TYPE_REVERT), POST_ACTION_RUN,
                  "unconfirmed + REVERT (just-swapped image) must RUN POST, not defer");
}

ZTEST(firmware_confirm_decide, test_unconfirmed_none_runs_post)
{
    zassert_equal(firmware_confirm_decide(false, BOOT_SWAP_TYPE_NONE), POST_ACTION_RUN,
                  "unconfirmed + NONE (e.g. factory image) must RUN POST");
}

ZTEST(firmware_confirm_decide, test_unconfirmed_test_swap_defers)
{
    /* TEST = a swap queued for next boot; we are still on the OLD image — defer. */
    zassert_equal(firmware_confirm_decide(false, BOOT_SWAP_TYPE_TEST), POST_ACTION_DEFER,
                  "unconfirmed + queued TEST swap must defer to the next boot");
}
```
