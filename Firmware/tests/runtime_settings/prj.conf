## CMakeLists.txt
```
cmake_minimum_required(VERSION 3.20.0)
find_package(Zephyr REQUIRED HINTS $ENV{ZEPHYR_BASE})
project(test_runtime_settings)

set(APP_SRC ${CMAKE_CURRENT_SOURCE_DIR}/../../src)

# The modules under test: the NVS-backed persistence engine (runtime_settings.c)
# and the UDS DID layer that maps wire values to fields and drives the
# volatile/persist paths (uds_settings.c). main.c stubs op_error_publish so the
# full error/zbus subsystem is not pulled into the host binary.
target_sources(app PRIVATE
    src/main.c
    ${APP_SRC}/runtime_settings.c
    ${APP_SRC}/external_flash.c
    ${APP_SRC}/divecan/uds/uds_settings.c
)
target_include_directories(app PRIVATE
    ${CMAKE_CURRENT_SOURCE_DIR}/../../include
    ${APP_SRC}/divecan/include
    ${APP_SRC}
)

# glibc gates some libc symbols behind _POSIX_C_SOURCE on the native_sim host
# build — the production STM32 picolibc exposes them unconditionally.
target_compile_definitions(app PRIVATE _POSIX_C_SOURCE=200809L)
```

## Kconfig
```
mainmenu "runtime_settings persistence test"

# Pull in the full product-topology menu so runtime_settings.c's BUILD_ASSERTs
# (exactly-one-cell-type, exactly-one-power-mode) and runtime_settings.h's
# default/valid-mode tables resolve from real Kconfig defaults rather than
# hand-maintained -D defines. The all-default config (3 analog cells, battery
# power, LI2S, no solenoid) is internally consistent: PPO2 default Off, Cal
# default Absolute — both in their valid sets.
rsource "../../src/Kconfig"

source "Kconfig.zephyr"
```

## prj.conf
```kconfig
CONFIG_ZTEST=y
CONFIG_LOG=y

# Real settings persistence over NVS on the native_sim flash_simulator
# (storage_partition @ 0xfc000 in the native_sim DTS). This exercises the
# genuine save -> reload round-trip path that the HIL config suite leans on,
# so quantization, zero-value, and coherence behaviours surface here rather
# than only as flaky HIL reds.
CONFIG_FLASH=y
CONFIG_FLASH_MAP=y
CONFIG_FLASH_PAGE_LAYOUT=y
CONFIG_NVS=y
CONFIG_SETTINGS=y
CONFIG_SETTINGS_NVS=y
```

## src/main.c
```c
/**
 * @file main.c
 * @brief runtime_settings + uds_settings persistence tests (real NVS backend)
 *
 * Exercises the settings save/load path that the HIL config suite leans on, on
 * the native_sim flash_simulator (storage_partition). The goal is to pin the
 * NVS quirks documented in the settings-save-nvs-quirks memory as DETERMINISTIC
 * native results instead of flaky HIL reds:
 *
 *   #3 back-to-back / coherence : UDS_SaveSettingValue reloads NVS mid-call and
 *      re-derives a single field, silently discarding any volatile change to a
 *      DIFFERENT field that was already applied to the live cache.
 *   #5 PID gain quantization    : gains are stored as float32 micro-units-/1e6,
 *      so arbitrary integers do not round-trip (write 9 -> read 8).
 *   #6 Kp == 0 anomaly          : isolates the observed silent-no-response to
 *      the ISO-TP layer by proving the PERSIST path itself accepts/stores 0.
 *
 * Tests asserting the INTENDED post-refactor behaviour (#3 coherence, #5 exact
 * round-trip) are EXPECTED RED until Phase 2 lands. The rest are green and act
 * as regression guards.
 */

#include <zephyr/ztest.h>
#include <zephyr/settings/settings.h>
#include <string.h>

#include "runtime_settings.h"
#include "uds_settings.h"
#include "errors.h"

/* Setting indices — mirror the private #defines in uds_settings.c. */
#define IDX_PPO2     1U
#define IDX_CAL      2U
#define IDX_DEPTH    3U
#define IDX_KP       4U
#define IDX_KI       5U
#define IDX_KD       6U
#define IDX_BATTERY  7U
#define IDX_IDENTITY 11U

/* Battery enum values (BatteryType_t): 9V=0, LI1S=1, LI2S=2 (default), LI3S=3. */
/* Identity enum values (DiveCANIdentity_t): SOLO=0 (default), OBOE=1. */

/**
 * @brief Stub for op_error_publish() — keeps the error/zbus subsystem out of
 *        the host binary. The modules under test call it via OP_ERROR macros.
 */
void op_error_publish(OpError_t code, uint32_t detail)
{
    (void)code;
    (void)detail;
}

/** @brief Reload the cache from NVS — models a reboot (boot calls this once). */
static void reboot_sim(void)
{
    RuntimeSettings_t rs;
    (void)runtime_settings_load(&rs);
}

/** @brief Suite setup: initialise the settings subsystem once. */
static void *rs_setup(void)
{
    reboot_sim();
    return NULL;
}

/**
 * @brief Per-test reset: normalise NVS + cache to defaults so tests are
 *        order-independent despite the flash_simulator persisting in-process.
 */
static void rs_before(void *fixture)
{
    ARG_UNUSED(fixture);
    RuntimeSettings_t def = RUNTIME_SETTINGS_DEFAULT;
    reboot_sim();                  /* ensure subsystem initialised */
    (void)runtime_settings_save(&def);
    reboot_sim();                  /* sync cache to the freshly-written defaults */
}

ZTEST_SUITE(runtime_settings, NULL, rs_setup, rs_before, NULL, NULL);

/* ---- Persistence round-trip (green regression guards) ---- */

/** @brief A saved battery type survives a reboot. */
ZTEST(runtime_settings, test_persist_battery_roundtrip)
{
    zassert_true(UDS_SaveSettingValue(IDX_BATTERY, 3U)); /* LI3S */
    reboot_sim();
    zassert_equal(UDS_GetSettingValue(IDX_BATTERY), 3U);
}

/** @brief The default DiveCAN identity is SOLO (0) on a clean baseline. */
ZTEST(runtime_settings, test_identity_default_is_solo)
{
    zassert_equal(UDS_GetSettingValue(IDX_IDENTITY), 0U,
              "default broadcast identity must be SOLO (0)");
    zassert_equal((int)runtime_settings_get_divecan_id(),
              (int)DIVECAN_IDENTITY_SOLO);
}

/** @brief A saved OBOE identity survives a reboot and maps to the OBOE enum. */
ZTEST(runtime_settings, test_persist_identity_roundtrip)
{
    zassert_true(UDS_SaveSettingValue(IDX_IDENTITY, 1U)); /* OBOE */
    reboot_sim();
    zassert_equal(UDS_GetSettingValue(IDX_IDENTITY), 1U);
    zassert_equal((int)runtime_settings_get_divecan_id(),
              (int)DIVECAN_IDENTITY_OBOE);

    /* Reverting to SOLO also persists. */
    zassert_true(UDS_SaveSettingValue(IDX_IDENTITY, 0U));
    reboot_sim();
    zassert_equal(UDS_GetSettingValue(IDX_IDENTITY), 0U);
}

/** @brief An out-of-range identity value is rejected by both paths. */
ZTEST(runtime_settings, test_identity_rejects_out_of_range)
{
    zassert_false(UDS_SetSettingValue(IDX_IDENTITY, 2U),
              "identity only accepts 0 (SOLO) or 1 (OBOE)");
    zassert_false(UDS_SaveSettingValue(IDX_IDENTITY, 2U));
}

/**
 * @brief A PID gain that is float-exact (250000 micro-units = 0.25)
 *        round-trips cleanly through save + reboot.
 */
ZTEST(runtime_settings, test_persist_pid_gain_clean_multiple)
{
    zassert_true(UDS_SaveSettingValue(IDX_KP, 250000U)); /* 0.25f */
    reboot_sim();
    zassert_equal(UDS_GetSettingValue(IDX_KP), 250000U);
}

/** @brief Saving PID Kp = 0 persists as 0 (proves #6 is NOT a persist-path bug). */
ZTEST(runtime_settings, test_pid_kp_zero_persists)
{
    zassert_true(UDS_SaveSettingValue(IDX_KP, 0U));
    reboot_sim();
    zassert_equal(UDS_GetSettingValue(IDX_KP), 0U,
              "persist path must store 0 exactly; the silent-response anomaly "
              "is in the ISO-TP ACK layer, not here");
}

/* ---- Intended-behaviour tests (EXPECTED RED until Phase 2) ---- */

/**
 * @brief #5: an arbitrary integer micro-unit gain should round-trip EXACTLY.
 *
 * Nine micro-units represents a small tuned integral gain of 0.000009.
 */
ZTEST(runtime_settings, test_pid_gain_exact_roundtrip)
{
    zassert_true(UDS_SaveSettingValue(IDX_KP, 9U));
    reboot_sim();
    zassert_equal(UDS_GetSettingValue(IDX_KP), 9U,
              "PID gain must round-trip exactly (got %llu, want 9)",
              (unsigned long long)UDS_GetSettingValue(IDX_KP));
}

/**
 * @brief #3: saving one field must not discard a pending volatile change to another.
 *
 * RED today: UDS_SaveSettingValue() calls runtime_settings_load() internally,
 * which resets the live cache to NVS contents, wiping the volatile battery
 * change before persisting only Kp. The user's edit silently reverts.
 */
ZTEST(runtime_settings, test_volatile_change_survives_save_of_other_field)
{
    /* Volatile edit to battery (0x9130 path). */
    zassert_true(UDS_SetSettingValue(IDX_BATTERY, 3U)); /* LI3S */
    zassert_equal(UDS_GetSettingValue(IDX_BATTERY), 3U,
              "volatile edit must take effect immediately");

    /* Persist a DIFFERENT field (Kp). The battery edit must not vanish. */
    zassert_true(UDS_SaveSettingValue(IDX_KP, 250000U));

    zassert_equal(UDS_GetSettingValue(IDX_BATTERY), 3U,
              "saving Kp must not revert the volatile battery edit (got %llu)",
              (unsigned long long)UDS_GetSettingValue(IDX_BATTERY));
}

/* ---- Validation parity guard ---- */

/**
 * @brief From a clean baseline, the volatile path and the persist path must
 *        agree on which values they accept (no asymmetric NRC). Green guard:
 *        if it ever goes red, the validate logic has diverged between paths.
 */
ZTEST(runtime_settings, test_set_save_agree_clean_baseline)
{
    /* Battery: all four chemistries valid; Cal: only Absolute(1)/TotalAbs(2)
     * valid on this no-solenoid, no-digital build; PID micro-units valid. */
    const struct { uint8_t idx; uint64_t val; } cases[] = {
        {IDX_BATTERY, 0U}, {IDX_BATTERY, 1U}, {IDX_BATTERY, 3U},
        {IDX_CAL, 1U}, {IDX_CAL, 2U},
        {IDX_KP, 250000U}, {IDX_KI, 29U},
    };

    for (size_t i = 0; i < ARRAY_SIZE(cases); ++i) {
        rs_before(NULL); /* clean baseline before each pair */
        bool set_ok = UDS_SetSettingValue(cases[i].idx, cases[i].val);
        rs_before(NULL);
        bool save_ok = UDS_SaveSettingValue(cases[i].idx, cases[i].val);
        zassert_equal(set_ok, save_ok,
                  "idx %u val %llu: volatile=%d persist=%d (asymmetric)",
                  cases[i].idx, (unsigned long long)cases[i].val,
                  set_ok, save_ok);
    }
}
```
