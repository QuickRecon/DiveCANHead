## CMakeLists.txt
```
cmake_minimum_required(VERSION 3.20.0)

# Wrap flash, MCUBoot, and ISO-TP send symbols so the OTA pipeline can be
# exercised without a real flash backend or CAN driver. Must be set BEFORE
# find_package(Zephyr) so they apply to the final executable link, not just
# the `app` static library.
add_link_options(
    -Wl,--wrap=flash_area_open
    -Wl,--wrap=flash_area_close
    -Wl,--wrap=flash_area_read
    -Wl,--wrap=flash_area_erase
    -Wl,--wrap=flash_img_init_id
    -Wl,--wrap=flash_img_buffered_write
    -Wl,--wrap=flash_img_check
    -Wl,--wrap=boot_read_bank_header
    -Wl,--wrap=boot_request_upgrade
    -Wl,--wrap=boot_is_img_confirmed
    -Wl,--wrap=sys_reboot
    -Wl,--wrap=ISOTP_Send
)

find_package(Zephyr REQUIRED HINTS $ENV{ZEPHYR_BASE})
project(test_uds_ota)

set(APP_SRC ${CMAKE_CURRENT_SOURCE_DIR}/../../src)

target_sources(app PRIVATE
    src/main.c
    ${APP_SRC}/divecan/uds/uds.c
    ${APP_SRC}/divecan/uds/uds_ota.c
    ${APP_SRC}/external_flash.c
    ${APP_SRC}/maintenance_arena.c
    ${APP_SRC}/divecan/divecan_channels.c
    ${APP_SRC}/errors.c
)
# uds_state_did.c and uds_settings.c are deliberately excluded — they pull
# in DT-resolved power and oxygen-cell devices that don't exist on
# native_sim. Stubs for the symbols uds.c needs from them live in main.c.

target_include_directories(app PRIVATE
    ${CMAKE_CURRENT_SOURCE_DIR}/include
    ${APP_SRC}/divecan/include
    ${APP_SRC}
    ${CMAKE_CURRENT_SOURCE_DIR}/../../include
)

# glibc gates strnlen() etc. behind _POSIX_C_SOURCE on the native_sim host
# build — the production STM32 picolibc exposes them unconditionally.
target_compile_definitions(app PRIVATE _POSIX_C_SOURCE=200809L)
```

## prj.conf
```kconfig
CONFIG_ZTEST=y
CONFIG_LOG=y
CONFIG_ZBUS=y

# uds.c uses k_uptime_get_32 and (transitively via uds_ota.c) sys_reboot.
CONFIG_REBOOT=y

# State Machine Framework — flat-only.
CONFIG_SMF=y
# CONFIG_SMF_ANCESTOR_SUPPORT is not set
# CONFIG_SMF_INITIAL_TRANSITION is not set

# Pulled in by uds_settings.c and uds_state_did.c. We don't exercise the
# settings or state-DID paths in the OTA test, but the modules link against
# the OTA dispatch through uds.c so they must compile.
CONFIG_SETTINGS=y
CONFIG_SETTINGS_RUNTIME=y

# We deliberately do NOT enable BOOTLOADER_MCUBOOT here — it y-selects
# USE_DT_CODE_PARTITION which doesn't apply to native_sim. All boot_*,
# flash_img_*, and flash_area_* symbols are wrapped, so we never reach
# the real implementations. The headers we need (zephyr/dfu/mcuboot.h
# and zephyr/dfu/flash_img.h) are always available — they're not gated
# on the Kconfig.
CONFIG_FLASH=y
CONFIG_FLASH_MAP=y
CONFIG_STREAM_FLASH=y
CONFIG_IMG_MANAGER=y
CONFIG_IMG_ENABLE_IMAGE_CHECK=y
CONFIG_IMG_BLOCK_BUF_SIZE=512
```

## include/solenoid_roles.h
```c
/*
 * Test-local shadow for uds.c's solenoid-role include. OTA tests never
 * exercise solenoid control, and native_sim has no solenoid devicetree node.
 */
#ifndef TEST_SOLENOID_ROLES_H
#define TEST_SOLENOID_ROLES_H

#endif
```
