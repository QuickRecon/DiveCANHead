## CMakeLists.txt
```
cmake_minimum_required(VERSION 3.20.0)

# Wrap MCUBoot, factory_image, firmware_confirm, and the ISO-TP send
# symbol so the OTA DID handlers (both read 0xF270-0xF274 and write
# 0xF275-0xF277) can be exercised against a controlled fixture. Must be
# set BEFORE find_package(Zephyr) so they apply to the final executable
# link, not just the `app` static library.
add_link_options(
    -Wl,--wrap=boot_read_bank_header
    -Wl,--wrap=boot_is_img_confirmed
    -Wl,--wrap=mcuboot_swap_type
    -Wl,--wrap=boot_fetch_active_slot
    -Wl,--wrap=boot_request_upgrade
    -Wl,--wrap=sys_reboot
    -Wl,--wrap=factory_image_is_captured
    -Wl,--wrap=factory_image_get_version
    -Wl,--wrap=factory_image_get_sem_ver
    -Wl,--wrap=factory_image_restore_to_slot1
    -Wl,--wrap=factory_image_restore_async
    -Wl,--wrap=factory_image_force_capture_async
    -Wl,--wrap=firmware_confirm_get_state
    -Wl,--wrap=firmware_confirm_get_pass_mask
    -Wl,--wrap=errors_get_last_crash
    -Wl,--wrap=boot_history_get_crashes
    -Wl,--wrap=boot_history_get_reboots
    -Wl,--wrap=ISOTP_Send
)

find_package(Zephyr REQUIRED HINTS $ENV{ZEPHYR_BASE})
project(test_uds_state_did_ota)

set(APP_SRC ${CMAKE_CURRENT_SOURCE_DIR}/../../src)

target_sources(app PRIVATE
    src/main.c
    ${APP_SRC}/divecan/uds/uds.c
    ${APP_SRC}/divecan/uds/uds_state_did.c
    ${APP_SRC}/external_flash.c
    ${APP_SRC}/divecan/divecan_channels.c
    ${APP_SRC}/oxygen_cell_channels.c
    ${APP_SRC}/alarm.c
    ${APP_SRC}/errors.c
)
# uds_ota.c, uds_settings.c are deliberately excluded — they pull in
# transports + DT-resolved devices we don't need to exercise here.
# Stubs for the symbols uds.c references from them live in main.c.

target_include_directories(app PRIVATE
    # Test-local include shadow MUST come first — overrides the
    # production power_management.h whose POWER_DEVICE macro depends on
    # a DT node that doesn't exist on native_sim.
    ${CMAKE_CURRENT_SOURCE_DIR}/include
    ${APP_SRC}/divecan/include
    ${APP_SRC}
    ${CMAKE_CURRENT_SOURCE_DIR}/../../include
)

# uds_state_did.c uses CONFIG_CELL_COUNT to size the per-cell channel
# pointer table. oxygen_cell_channels.c uses the same Kconfig to gate
# chan_cell_2/3 definitions. Force the production value here.
target_compile_definitions(app PRIVATE
    CONFIG_CELL_COUNT=3
    CONFIG_CELL_1_TYPE_DIVEO2=1
    CONFIG_CELL_2_TYPE_DIVEO2=1
    CONFIG_CELL_3_TYPE_ANALOG=1
    CONFIG_HAS_PRESSURE_TRANSDUCER=1
    CONFIG_O2_TRANSDUCER_CHANNEL=1
    CONFIG_DIL_TRANSDUCER_CHANNEL=0
)

# glibc gates strnlen() etc. behind _POSIX_C_SOURCE on the native_sim host
# build — the production STM32 picolibc exposes them unconditionally.
target_compile_definitions(app PRIVATE _POSIX_C_SOURCE=200809L)
```

## prj.conf
```kconfig
CONFIG_ZTEST=y
CONFIG_LOG=y
CONFIG_ZBUS=y

# uds.c uses k_uptime_get_32. sys_reboot is wrapped but the header
# requires CONFIG_REBOOT for the prototype to be visible.
CONFIG_REBOOT=y

# Pulled in transitively. We don't exercise the settings paths but the
# settings subsystem links against the dispatcher in uds.c.
CONFIG_SETTINGS=y
CONFIG_SETTINGS_RUNTIME=y

# Same rationale as tests/uds_ota: we deliberately do NOT enable
# BOOTLOADER_MCUBOOT — it y-selects USE_DT_CODE_PARTITION which doesn't
# apply to native_sim. All boot_*, flash_img_*, flash_area_* and
# factory_image_* symbols are wrapped, so we never reach the real
# implementations. The headers we need are always available.
CONFIG_FLASH=y
CONFIG_FLASH_MAP=y
```

## include/power_management.h
```c
/**
 * @file power_management.h
 * @brief Test-only shim that shadows the production header.
 *
 * The production POWER_DEVICE macro expands to
 * `DEVICE_DT_GET(DT_NODELABEL(power))`, which fails to compile on
 * native_sim because the `power` DT node doesn't exist. This shim
 * defines POWER_DEVICE as NULL and re-declares the power_get_* function
 * prototypes; the test main.c provides empty stub bodies for them.
 */

#ifndef POWER_MANAGEMENT_H
#define POWER_MANAGEMENT_H

#include <zephyr/device.h>
#include "common.h"

#define POWER_DEVICE NULL

Numeric_t power_get_vbus_voltage(const struct device *dev);
Numeric_t power_get_vcc_voltage(const struct device *dev);
Numeric_t power_get_battery_voltage(const struct device *dev);
Numeric_t power_get_can_voltage(const struct device *dev);
Numeric_t power_get_low_battery_threshold(void);

#endif /* POWER_MANAGEMENT_H */
```

## include/solenoid_roles.h
```c
/*
 * Test-local shadow for uds.c's solenoid-role include. OTA DID tests never
 * exercise solenoid control, and native_sim has no solenoid devicetree node.
 */
#ifndef TEST_SOLENOID_ROLES_H
#define TEST_SOLENOID_ROLES_H

#endif
```
