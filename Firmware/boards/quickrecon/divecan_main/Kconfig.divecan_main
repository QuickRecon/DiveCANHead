## Firmware/boards/quickrecon/divecan_main/board.yml
```yaml
board:
  name: divecan_main
  full_name: DiveCAN MainPCB Head
  vendor: quickrecon
  socs:
    - name: stm32l431xx
```

## Firmware/drivers/sd_flash/Kconfig
```kconfig
config QUICKRECON_SD_FLASH
    bool "Raw SD block device exposed as flash"
    default y
    depends on FLASH
    depends on DISK_ACCESS
    depends on DT_HAS_QUICKRECON_SD_FLASH_ENABLED
    select FLASH_HAS_EXPLICIT_ERASE
    select FLASH_PAGE_LAYOUT
    help
      Expose a fixed raw region of an SD disk through Zephyr's flash API.
      This preserves the existing flash_map, MCUboot, NVS, FCB, and factory
      image implementations on DiveCAN boards which use SD instead of NOR.
      No filesystem is mounted or required.

if QUICKRECON_SD_FLASH

config QUICKRECON_SD_FLASH_INIT_PRIORITY
    int "Raw SD flash adapter init priority"
    default 91
    range 91 99
    help
      Device initialization priority.  This must be later than the backing
      SDMMC disk driver, whose default priority is 90.

module = QUICKRECON_SD_FLASH
module-str = quickrecon_sd_flash
source "subsys/logging/Kconfig.template.log_config"

endif
```

## Firmware/drivers/sd_flash/dts/bindings/flash_controller/quickrecon,sd-flash.yaml
```yaml
description: |
  Raw SD block range exposed through Zephyr's flash API.

  The adapter translates byte-addressed flash reads, aligned flash writes,
  and explicit erase-to-0xff operations into 512-byte disk accesses.  It does
  not mount or interpret a filesystem.

compatible: "quickrecon,sd-flash"

include: base.yaml

properties:
  disk-name:
    type: string
    required: true
    description: Disk Access name exported by the backing SD driver.

  size:
    type: int
    required: true
    description: Size in bytes of the raw SD range exposed as flash.

  erase-block-size:
    type: int
    required: true
    description: Logical flash erase-page size in bytes.

  write-block-size:
    type: int
    required: true
    description: Minimum aligned flash write size in bytes.
```

## Firmware/drivers/solenoid/Kconfig
```kconfig
config SOLENOID
	bool "Solenoid driver with hardware deadman timer"
	depends on GPIO && COUNTER
	default y
	help
	  Driver for GPIO-based solenoid outputs with a hardware
	  counter acting as a deadman timer. When the counter alarm
	  fires, all solenoid outputs are forced low from ISR context.

config SOLENOID_CURRENT_CHECK
	bool "Closed-loop solenoid current check"
	depends on SOLENOID
	default n
	help
	  Sample the generic whole-device current API (device_current.h) just
	  before energising a solenoid channel and again at the end of its
	  on-window, then classify the draw as normal / under / over current and
	  raise OP_ERROR on a debounced fault. The verdict is exposed via the
	  pollable status API for a higher layer to broadcast/log.

	  Opt-in: enable this only on a variant that registers a current provider
	  (e.g. the Poseidon DS2782 fuel gauge, or a board with an on-board
	  solenoid/rail shunt) AND sets the measured fire-current window below in
	  its variant conf. The default-off state is the globally-applicable one:
	  a board with no provider would only ever read "normal", so there is
	  nothing to gain from compiling the check in.

config SOLENOID_CURRENT_DELTA_MIN_UA
	int "Minimum expected solenoid fire-current delta (uA)"
	depends on SOLENOID_CURRENT_CHECK
	default 0
	help
	  A fire whose (fire - idle) current delta falls below this reads as
	  UNDER-current (open coil / boost fault / stuck valve).

	  The default is a wide-open placeholder that never raises a fault; each
	  variant that enables the check sets its own measured lower bound in its
	  conf (e.g. Poseidon_Aren.conf sets 150 mA).

config SOLENOID_CURRENT_DELTA_MAX_UA
	int "Maximum expected solenoid fire-current delta (uA)"
	depends on SOLENOID_CURRENT_CHECK
	default 1000000000
	help
	  A fire whose (fire - idle) current delta rises above this reads as
	  OVER-current (possible short).

	  The default is a wide-open placeholder (~1 kA) that never raises a
	  fault; each variant that enables the check sets its own measured upper
	  bound in its conf (e.g. Poseidon_Aren.conf sets 250 mA).

config SOLENOID_INIT_PRIORITY
	int "Solenoid driver init priority"
	depends on SOLENOID
	default 90
	help
	  Must be after GPIO and counter drivers (typically 80).

config SOLENOID_LOG_LEVEL
	int "Solenoid driver log level"
	depends on SOLENOID
	default 3
	range 0 4
```

## Firmware/src/Kconfig.factory_image
```kconfig
# Kconfig fragment for the factory-image backup module (factory_image.c).
#
# Same standalone-file pattern as Kconfig.firmware_confirm so the
# tests/factory_image/ native_sim suite can source it directly without
# the rest of the product-topology menu.

config FACTORY_IMAGE
	bool "Factory image backup module"
	default y
	depends on FLASH_MAP
	help
	  Compile in src/factory_image.c. On first boot the running slot0
	  image is captured to an external storage backend (flash partition
	  by default), and that copy is restorable over UDS by the operator
	  if a confirmed OTA later turns out to be unrecoverable in some way
	  the POST gate can't catch.

if FACTORY_IMAGE

choice FACTORY_IMAGE_BACKEND
	prompt "Factory image backup backend"
	default FACTORY_IMAGE_BACKEND_FLASH

config FACTORY_IMAGE_BACKEND_FLASH
	bool "Dedicated flash partition (factory-image label in DTS)"
	depends on FLASH_MAP
	help
	  Store the factory image in a dedicated flash partition labelled
	  factory-image. Required for the divecan_jr hardware (external
	  W25Q512JV NOR).

config FACTORY_IMAGE_BACKEND_FS
	bool "File on a mounted filesystem (SD card)"
	depends on FILE_SYSTEM
	help
	  Store the factory image as ``factory.img`` on a mounted
	  filesystem volume. The captured-flag is signalled by the presence
	  of a ``factory.ok`` sidecar file written only after fs_sync
	  succeeds. For older hardware variants that host slot1 + the
	  factory backup on an SD card instead of dedicated NOR.

endchoice

config FACTORY_IMAGE_CAPTURE_ON_BOOT
	bool "Auto-capture factory image on first confirmed boot"
	default y
	help
	  When set, factory_image_maybe_capture_async() runs unconditionally
	  on every confirmed cold boot. It's a no-op if the captured flag is
	  already set, so the actual capture only happens once. Disable for
	  bench builds that want to manually decide when to bless an image as
	  the factory baseline.

config FACTORY_IMAGE_CHUNK_SIZE
	int "Per-iteration chunk size in bytes"
	default 1024
	range 256 8192
	help
	  RAM size of the read/write buffer used by the slot0-to-factory
	  copy loop. The bulk erase of the destination region happens
	  before the copy loop starts via a single flash_area_erase() call,
	  so chunk size has no relationship to the SPI NOR sector erase
	  size — it only controls per-iteration RAM cost and the number of
	  loop iterations. 1 KB is a reasonable default; the loop feeds the
	  watchdog between iterations so even 256 B is safe.

endif # FACTORY_IMAGE
```

## Firmware/tests/ads1x1x_driver/testcase.yaml
```yaml
tests:
  drivers.adc.ads1x1x.multichannel:
    platform_allow: native_sim
    tags: adc ads1x1x drivers
```

## Firmware/tests/device_current/testcase.yaml
```yaml
tests:
  divecan.device_current:
    platform_allow:
      - native_sim
      - native_sim/native/64
    tags:
      - device_current
      - unit
```

## Firmware/tests/diveo2_thread/testcase.yaml
```yaml
tests:
  oxygen_cell.diveo2_thread:
    platform_allow: native_sim
    tags: oxygen_cell diveo2 uart
```

## Firmware/tests/i2c_bus_lock/testcase.yaml
```yaml
tests:
  divecan.i2c_bus_lock:
    platform_allow:
      - native_sim
      - native_sim/native/64
    tags:
      - i2c
      - recovery
      - unit
```

## Firmware/tests/maintenance_arena/testcase.yaml
```yaml
tests:
  maintenance_arena.arena:
    platform_allow: native_sim
    tags: maintenance_arena arena
```

## Firmware/tests/o2s_thread/testcase.yaml
```yaml
tests:
  oxygen_cell.o2s_thread:
    platform_allow: native_sim
    tags: oxygen_cell o2s uart
```

## Firmware/tests/poseidon_accessories/testcase.yaml
```yaml
tests:
  divecan.poseidon_accessories:
    platform_allow:
      - native_sim
      - native_sim/native/64
    tags:
      - poseidon
      - i2c
      - unit
```

## Firmware/tests/ppo2_autotune_math/testcase.yaml
```yaml
tests:
  ppo2_autotune.math:
    platform_allow: native_sim
    tags: ppo2_control pid autotune
```

## Firmware/tests/runtime_settings/testcase.yaml
```yaml
tests:
  divecan.runtime_settings:
    platform_allow: native_sim
    tags: divecan settings nvs
```

## Firmware/tests/runtime_settings_logic/testcase.yaml
```yaml
tests:
  divecan.runtime_settings_logic:
    platform_allow: native_sim
    tags: divecan settings nvs
```

## Firmware/tests/sd_flash/testcase.yaml
```yaml
tests:
  drivers.flash.raw_sd:
    platform_allow: native_sim
    tags: disk flash sd
```
