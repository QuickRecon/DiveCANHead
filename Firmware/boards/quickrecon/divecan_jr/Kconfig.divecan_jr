## Firmware/boards/quickrecon/divecan_jr/board.yml
```yaml
board:
  name: divecan_jr
  full_name: DiveCAN Jr Head
  vendor: quickrecon
  socs:
    - name: stm32l431xx
```

## Firmware/boards/quickrecon/divecan_jr/divecan_jr_defconfig
```kconfig
# MPU and stack protection
CONFIG_ARM_MPU=y
CONFIG_HW_STACK_PROTECTION=y

# GPIO
CONFIG_GPIO=y

# Console via RTT (no UART consumed)
CONFIG_CONSOLE=y
CONFIG_USE_SEGGER_RTT=y
CONFIG_RTT_CONSOLE=y

# CAN
CONFIG_CAN=y

# I2C
CONFIG_I2C=y

# UART (sensor cells — DMA-backed async API for receive-to-idle)
CONFIG_SERIAL=y
CONFIG_UART_ASYNC_API=y
CONFIG_DMA=y

# SPI (external flash)
CONFIG_SPI=y

# External ADC (ADS1115)
CONFIG_ADC=y
CONFIG_ADC_ADS1X1X=y

# Internal VBAT sensor — used as the VCC rail voltage source on Jr
# (VCC == VBUS physically; both share the regulator). The vbat driver
# applies the chip's internal 1/3 divider and reports VDD via the
# sensor API.
CONFIG_SENSOR=y
CONFIG_STM32_VBAT=y

# External flash
CONFIG_FLASH=y
CONFIG_SPI_NOR=y
CONFIG_SPI_NOR_SFDP_RUNTIME=y

# Counter (solenoid deadman timer)
CONFIG_COUNTER=y

# Regulator (VBUS power rail control)
# Init priority 45: after GPIO (40), before I2C/SPI/UART (50) so that
# VBUS is powered before any bus drivers try to talk to peripherals.
CONFIG_REGULATOR=y
CONFIG_REGULATOR_FIXED_INIT_PRIORITY=45

# Watchdog
CONFIG_WATCHDOG=y

# Power management — needed by power_management.c::power_shutdown() to
# suspend the cell UARTs before entering STM32 SHUTDOWN.
CONFIG_PM_DEVICE=y

# Note: CONFIG_USE_STM32_HAL_PWR_EX is selected from src/Kconfig
# (DIVECAN_HAL_PWR_EX) because the upstream symbol has no prompt and
# only stm32wbax SoCs select it by default.

# Settings subsystem (NVS-backed runtime config)
CONFIG_NVS=y
CONFIG_SETTINGS=y
CONFIG_SETTINGS_NVS=y
CONFIG_SETTINGS_RUNTIME=y
CONFIG_FLASH_MAP=y
CONFIG_FLASH_PAGE_LAYOUT=y
```

## Firmware/drivers/gpio_sim/Kconfig
```kconfig
config GPIO_SIM
    bool "GPIO emulator with external drive simulation"
    depends on GPIO
    default y if DT_HAS_QUICKRECON_GPIO_SIM_ENABLED
    help
      GPIO emulator that tracks externally-driven pins. Pins set via
      gpio_sim_drive() preserve their value through pull-up/pull-down
      reconfigurations, simulating real pin capacitance behavior.
```

## Firmware/tests/analog_math/testcase.yaml
```yaml
tests:
  oxygen_cell.analog_math:
    platform_allow: native_sim
    tags: oxygen_cell analog
```

## Firmware/tests/calibration_math/testcase.yaml
```yaml
tests:
  oxygen_cell.calibration_math:
    platform_allow: native_sim
    tags: oxygen_cell calibration
```

## Firmware/tests/calibration_sm/testcase.yaml
```yaml
tests:
  calibration.sm:
    platform_allow: native_sim
    tags: calibration smf
```

## Firmware/tests/consensus/testcase.yaml
```yaml
tests:
  oxygen_cell.consensus:
    platform_allow: native_sim
    tags: oxygen_cell consensus
```

## Firmware/tests/integration/Kconfig
```kconfig
config INTEGRATION_TEST_SHIM
    bool "Integration test shim (native_sim only)"
    depends on BOARD_NATIVE_SIM
    help
      Compiles in the test shim thread that bridges emulated peripherals
      (uart_emul, adc_emul, gpio_emul) to an external Python test harness
      via a Unix domain socket. Only available on native_sim builds.

config ADC_EMUL_CONFIGURABLE_INPUTS
    bool "Enable ADC configurable inputs for emulated ADC"
    depends on ADC_EMUL
    select ADC_CONFIGURABLE_INPUTS
    help
      The real ADS1115 driver selects ADC_CONFIGURABLE_INPUTS so the
      adc_channel_cfg struct includes input_positive/input_negative
      fields. The adc_emul driver does not select this by default.
      Enable it so the firmware compiles identically on native_sim.
```

## Firmware/tests/parsers/testcase.yaml
```yaml
tests:
  oxygen_cell.parsers:
    platform_allow: native_sim
    tags: oxygen_cell parsers
```

## Firmware/tests/power/testcase.yaml
```yaml
tests:
  power.voltage_math:
    platform_allow: native_sim
    tags: power voltage
```

## Firmware/tests/ppo2_broadcast/testcase.yaml
```yaml
tests:
  divecan.ppo2_broadcast:
    platform_allow: native_sim
    tags: divecan ppo2
```

## Firmware/tests/ppo2_control_math/testcase.yaml
```yaml
tests:
  ppo2_control.math:
    platform_allow: native_sim
    tags: ppo2_control pid solenoid
```

## Firmware/tests/zbus_integration/testcase.yaml
```yaml
tests:
  oxygen_cell.zbus_integration:
    platform_allow: native_sim
    tags: oxygen_cell zbus integration
```
