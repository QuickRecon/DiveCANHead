# AVR64EA48 device description
Architecture: AVR8X; Family: AVR
Programming and debug interfaces: UPDI
Registers are 8-bit, read-write, reset 0x0 unless marked. A register's access mark holds for its fields unless they carry their own. Offsets are from the block's base; lines under a group give offsets from that group; [hi:lo] are bit positions; {n}, {i} and the like mark numbered series; 'fields as' and 'values as' point back to an identical list; <NAME> marks a mode.

## Ordering variants
AVR64EA48: VQFN48, pinout QFN48, up to 20 MHz, -40 to 125 C, 1.8 to 5.5 V

## Memory
data space: start 0x0000 size 0x10000, little endian
  0x00 IO size 0x103F io, rw
  0x1040 LOCKBITS size 0x04 lockbits, rw, page 0x4
  0x1050 FUSES size 0x10 fuses, rw, page 0x8
  0x1080 USER_SIGNATURES size 0x40 user_signatures, rw, page 0x40
  0x1100 SIGNATURES size 0x03 signatures, ro, page 0x80
  0x1103 PROD_SIGNATURES size 0x7D signatures, ro, page 0x80
  0x1400 EEPROM size 0x200 eeprom, rw, page 0x8
  0x6800 INTERNAL_SRAM size 0x1800 ram, rw
  0x8000 MAPPED_PROGMEM size 0x8000 other, rw, page 0x80
prog space: start 0x0000 size 0x10000, little endian
  0x00 PROGMEM size 0x10000 flash, rw, executable, page 0x80
  0x00 PROGMEM_NRWW size 0x2000 flash, rw, executable, page 0x80
  0x2000 PROGMEM_RWW size 0xE000 flash, rw, executable, page 0x80

## Peripheral instances (address, pins/pin function, parameters)
AC0 at 0x0680 (AC)
  pins: AINN0 PD3/AINN; AINN1 PD0/AINN; AINN2 PD7/AINN; AINN3 PC2/AINN; AINP0 PD2/AINP; AINP1 PE0/AINP; AINP2 PE2/AINP; AINP3 PD6/AINP; AINP4 PC3/AINP; OUT PC6/ALT1 or PA7
  pin routing set by: PORTMUX.ACROUTEA.AC0
AC1 at 0x0688 (AC)
  pins: AINN0 PD5/AINN; AINN1 PD0/AINN; AINN2 PD7/AINN; AINP0 PD2/AINP; AINP1 PD3/AINP; AINP2 PD4/AINP; AINP3 PD6/AINP; AINP4 PC3/AINP; OUT PC6/ALT1 or PA7
  pin routing set by: PORTMUX.ACROUTEA.AC1
ADC0 at 0x0600 (ADC)
  pins: AINN{n} PD{n}/AINN (n=0..7); AINN8 PE0/AINN; AINN9 PE1/AINN; AINN10 PE2/AINN; AINN11 PE3/AINN; AINN16 PF0/AINN; AINN17 PF1/AINN; AINN18 PF2/AINN; AINN19 PF3/AINN; AINN20 PF4/AINN; AINN21 PF5/AINN; AINN22 PA2/AINN; AINN23 PA3/AINN; AINN24 PA4/AINN; AINN25 PA5/AINN; AINN26 PA6/AINN; AINN27 PA7/AINN; AINN28 PC0/AINN; AINN29 PC1/AINN; AINN30 PC2/AINN; AINN31 PC3/AINN; AINP{n} PD{n}/AINP (n=0..7); AINP8 PE0/AINP; AINP9 PE1/AINP; AINP10 PE2/AINP; AINP11 PE3/AINP; AINP16 PF0/AINP; AINP17 PF1/AINP; AINP18 PF2/AINP; AINP19 PF3/AINP; AINP20 PF4/AINP; AINP21 PF5/AINP; AINP22 PA2/AINP; AINP23 PA3/AINP; AINP24 PA4/AINP; AINP25 PA5/AINP; AINP26 PA6/AINP; AINP27 PA7/AINP; AINP28 PC0/AINP; AINP29 PC1/AINP; AINP30 PC2/AINP; AINP31 PC3/AINP
BOD at 0x00A0
CCL at 0x01C0
  pins: LUT0_IN0 PA0/IN; LUT0_IN1 PA1/IN; LUT0_IN2 PA2/IN; LUT1_IN0 PC0/IN; LUT1_IN1 PC1/IN; LUT1_IN2 PC2/IN; LUT2_IN0 PD0/IN; LUT2_IN1 PD1/IN; LUT2_IN2 PD2/IN; LUT3_IN0 PF0/IN; LUT3_IN1 PF1/IN; LUT3_IN2 PF2/IN; LUT0_OUT PA6/ALT1 or PA3; LUT1_OUT PC6/ALT1 or PC3; LUT2_OUT PD6/ALT1 or PD3; LUT3_OUT PF3
  pin routing set by: PORTMUX.CCLROUTEA.LUT0, PORTMUX.CCLROUTEA.LUT1, PORTMUX.CCLROUTEA.LUT2, PORTMUX.CCLROUTEA.LUT3
CLKCTRL at 0x0060
  pins: EXTCLK PA0/EXTCLK; CLKOUT PA7/OUT; XTAL32K1 PF0/XTAL; XTAL32K2 PF1/XTAL; XTALHF1 PA0/XTAL; XTALHF2 PA1/XTAL
CPU at 0x0030
  parameters: CORE_VERSION=V4S
CPUINT at 0x0110
CRCSCAN at 0x0120
DAC0 at 0x06A0 (DAC)
  pins: OUT PD6/VOUT
EVSYS at 0x0200
  pins: EVOUT0 PA7/ALT1 or PA2; EVOUT1 PB2; EVOUT2 PC7/ALT1 or PC2; EVOUT3 PD7/ALT1 or PD2; EVOUT4 PE2; EVOUT5 PF7/ALT1 or PF2
  pin routing set by: PORTMUX.EVSYSROUTEA.EVOUTA, PORTMUX.EVSYSROUTEA.EVOUTB, PORTMUX.EVSYSROUTEA.EVOUTC, PORTMUX.EVSYSROUTEA.EVOUTD, PORTMUX.EVSYSROUTEA.EVOUTE, PORTMUX.EVSYSROUTEA.EVOUTF
FUSE at 0x1050
GPR at 0x001C
LOCK at 0x1040
NVMCTRL at 0x1000
PORTA at 0x0400 (PORT)
  pins: PIN{n} PA{n}/IOPORT (n=0..7)
PORTB at 0x0420 (PORT)
  pins: PIN0 PB0/IOPORT; PIN1 PB1/IOPORT; PIN2 PB2/IOPORT; PIN3 PB3/IOPORT; PIN4 PB4/IOPORT; PIN5 PB5/IOPORT
PORTC at 0x0440 (PORT)
  pins: PIN{n} PC{n}/IOPORT (n=0..7)
PORTD at 0x0460 (PORT)
  pins: PIN{n} PD{n}/IOPORT (n=0..7)
PORTE at 0x0480 (PORT)
  pins: PIN0 PE0/IOPORT; PIN1 PE1/IOPORT; PIN2 PE2/IOPORT; PIN3 PE3/IOPORT
PORTF at 0x04A0 (PORT)
  pins: PIN{n} PF{n}/IOPORT (n=0..7)
PORTMUX at 0x05E0
RSTCTRL at 0x0040
  pins: RESET PF6/OTHER
RTC at 0x0140
SIGROW at 0x1100
SLPCTRL at 0x0050
SPI0 at 0x0940 (SPI)
  pins: MISO PE1/ALT1 or PA1/ALT3 or PD5/ALT4 or PC1/ALT5 or PC1/ALT6 or PA5; MOSI PE0/ALT1 or PA0/ALT3 or PD4/ALT4 or PC0/ALT5 or PC2/ALT6 or PA4; SCK PE2/ALT1 or PC0/ALT3 or PD6/ALT4 or PC2/ALT5 or PC3/ALT6 or PA6; SS PE3/ALT1 or PC1/ALT3 or PD7/ALT4 or PC3/ALT5 or PF7/ALT6 or PA7
  pin routing set by: PORTMUX.SPIROUTEA.SPI0
SYSCFG at 0x0F00
TCA0 at 0x0A00 (TCA)
  pins: WO0 PB0/ALT1 or PC0/ALT2 or PD0/ALT3 or PE0/ALT4 or PF0/ALT5 or PA0; WO1 PB1/ALT1 or PC1/ALT2 or PD1/ALT3 or PE1/ALT4 or PF1/ALT5 or PA1; WO2 PB2/ALT1 or PC2/ALT2 or PD2/ALT3 or PE2/ALT4 or PF2/ALT5 or PA2; WO3 PB3/ALT1 or PC3/ALT2 or PD3/ALT3 or PE3/ALT4 or PF3/ALT5 or PA3; WO4 PB4/ALT1 or PC4/ALT2 or PD4/ALT3 or PF4/ALT5 or PA4; WO5 PB5/ALT1 or PC5/ALT2 or PD5/ALT3 or PF5/ALT5 or PA5
  pin routing set by: PORTMUX.TCAROUTEA.TCA0
TCA1 at 0x0A40 (TCA)
  pins: WO0 PC4/ALT1 or PA4/ALT4 or PD4/ALT5 or PB0; WO1 PC5/ALT1 or PA5/ALT4 or PD5/ALT5 or PB1; WO2 PC6/ALT1 or PA6/ALT4 or PD6/ALT5 or PB2; WO3 PB3; WO4 PB4; WO5 PB5
  pin routing set by: PORTMUX.TCAROUTEA.TCA1
TCB0 at 0x0B00 (TCB)
  pins: WO0 PF4/ALT1 or PA2
  pin routing set by: PORTMUX.TCBROUTEA.TCB0
TCB1 at 0x0B10 (TCB)
  pins: WO0 PF5/ALT1 or PA3
  pin routing set by: PORTMUX.TCBROUTEA.TCB1
TCB2 at 0x0B20 (TCB)
  pins: WO0 PB4/ALT1 or PC0
  pin routing set by: PORTMUX.TCBROUTEA.TCB2
TCB3 at 0x0B30 (TCB)
  pins: WO0 PC1/ALT1 or PB5
  pin routing set by: PORTMUX.TCBROUTEA.TCB3
TWI0 at 0x0900 (TWI)
  pins: SCL PA3/ALT1 or PC3/ALT2 or PA1/ALT3 or PA3; SCL_DUAL PC7/ALT1 or PC7/ALT2 or PC3/ALT3 or PC3; SDA PA2/ALT1 or PC2/ALT2 or PA0/ALT3 or PA2; SDA_DUAL PC6/ALT1 or PC6/ALT2 or PC2/ALT3 or PC2
  pin routing set by: PORTMUX.TWIROUTEA.TWI0
USART0 at 0x0800 (USART)
  pins: RXD1 PA5/ALT1; TXD1 PA4/ALT1; XCK1 PA6/ALT1; XDIR1 PA7/ALT1; RXD2 PA3/ALT2; TXD2 PA2/ALT2; RXD3 PD5/ALT3; TXD3 PD4/ALT3; XCK3 PD6/ALT3; XDIR3 PD7/ALT3; RXD4 PC2/ALT4; TXD4 PC1/ALT4; XCK4 PC3/ALT4; RXD PA1; TXD PA0; XCK PA2; XDIR PA3
  pin routing set by: PORTMUX.USARTROUTEA.USART0
USART1 at 0x0820 (USART)
  pins: RXD PC5/ALT1 or PD7/ALT2 or PC1; TXD PC4/ALT1 or PD6/ALT2 or PC0; XCK PC6/ALT1 or PC2; XDIR PC7/ALT1 or PC3
  pin routing set by: PORTMUX.USARTROUTEA.USART1
USART2 at 0x0840 (USART)
  pins: RXD PF5/ALT1 or PF1; TXD PF4/ALT1 or PF0; XCK PF2; XDIR PF3
  pin routing set by: PORTMUX.USARTROUTEA.USART2
USERROW at 0x1080
VPORTA at 0x0000 (VPORT)
VPORTB at 0x0004 (VPORT)
VPORTC at 0x0008 (VPORT)
VPORTD at 0x000C (VPORT)
VPORTE at 0x0010 (VPORT)
VPORTF at 0x0014 (VPORT)
VREF at 0x00B0
  pins: VREFA PD7
WDT at 0x0100

## Interrupts
1 NMI (CRCSCAN)
2 VLM (BOD)
3 CFD (CLKCTRL)
4 CNT (RTC)
5 PIT (RTC)
6 CCL
7 PORT (PORTA)
8 LUNF (TCA0)
8 OVF (TCA0)
9 HUNF (TCA0)
10 CMP0 (TCA0)
10 LCMP0 (TCA0)
11 CMP1 (TCA0)
11 LCMP1 (TCA0)
12 CMP2 (TCA0)
12 LCMP2 (TCA0)
13 INT (TCB0)
14 INT (TCB1)
15 TWIS (TWI0)
16 TWIM (TWI0)
17 INT (SPI0)
18 RXC (USART0)
19 DRE (USART0)
20 TXC (USART0)
21 PORT (PORTD)
22 AC (AC0)
23 ERROR (ADC0)
24 RESRDY (ADC0)
25 SAMPRDY (ADC0)
26 AC (AC1)
27 PORT (PORTC)
28 INT (TCB2)
29 RXC (USART1)
30 DRE (USART1)
31 TXC (USART1)
32 PORT (PORTF)
33 EEREADY (NVMCTRL)
33 FLREADY (NVMCTRL)
33 NVMREADY (NVMCTRL)
34 RXC (USART2)
35 DRE (USART2)
36 TXC (USART2)
37 INT (TCB3)
38 LUNF (TCA1)
38 OVF (TCA1)
39 HUNF (TCA1)
40 CMP0 (TCA1)
40 LCMP0 (TCA1)
41 CMP1 (TCA1)
41 LCMP1 (TCA1)
42 CMP2 (TCA1)
42 LCMP2 (TCA1)
43 PORT (PORTE)
44 PORT (PORTB)

## Properties
SIGNATURES: SIGNATURE0=0x1E, SIGNATURE1=0x96, SIGNATURE2=0x1E

## Pinouts (pin number, pad)
QFN48: 1 PA5, 2 PA6, 3 PA7, 4 PB0, 5 PB1, 6 PB2, 7 PB3, 8 PB4, 9 PB5, 10 PC0, 11 PC1, 12 PC2, 13 PC3, 14 VDD2, 15 GND2, 16 PC4, 17 PC5, 18 PC6, 19 PC7, 20 PD0, 21 PD1, 22 PD2, 23 PD3, 24 PD4, 25 PD5, 26 PD6, 27 PD7, 28 VDD, 29 GND, 30 PE0, 31 PE1, 32 PE2, 33 PE3, 34 PF0, 35 PF1, 36 PF2, 37 PF3, 38 PF4, 39 PF5, 40 PF6, 41 PF7, 42 VDD1, 43 GND1, 44 PA0, 45 PA1, 46 PA2, 47 PA3, 48 PA4
