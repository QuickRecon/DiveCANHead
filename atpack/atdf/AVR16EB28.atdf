# AVR16EB28 device description
Architecture: AVR8X; Family: AVREB
Programming and debug interfaces: UPDI
Registers are 8-bit, read-write, reset 0x0 unless marked. A register's access mark holds for its fields unless they carry their own. Offsets are from the block's base; lines under a group give offsets from that group; [hi:lo] are bit positions; {n}, {i} and the like mark numbered series; 'fields as' and 'values as' point back to an identical list; <NAME> marks a mode.

## Ordering variants
AVR16EB28-SSOP/SPDIP: SOIC28, up to 20 MHz, -40 to 125 C, 1.8 to 5.5 V
AVR16EB28-VQFN: VQFN28, pinout QFN28, up to 20 MHz, -40 to 125 C, 1.8 to 5.5 V

## Memory
data space: start 0x0000 size 0x10000, little endian
  0x00 IO size 0x103F io, rw
  0x1040 LOCKBITS size 0x04 lockbits, rw, page 0x4
  0x1050 FUSES size 0x10 fuses, rw, page 0x8
  0x1080 SIGNATURES size 0x03 signatures, ro, page 0x80
  0x1083 PROD_SIGNATURES size 0x7D signatures, ro, page 0x80
  0x1100 BOOTROW size 0x40 user_signatures, rw, page 0x40
  0x1200 USER_SIGNATURES size 0x40 user_signatures, rw, page 0x40
  0x1400 EEPROM size 0x200 eeprom, rw, page 0x8
  0x7800 INTERNAL_SRAM size 0x800 ram, rw
  0x8000 MAPPED_PROGMEM size 0x4000 other, rw, page 0x40
prog space: start 0x0000 size 0x4000, little endian
  0x00 PROGMEM size 0x4000 flash, rw, executable, page 0x40
  0x00 PROGMEM_NRWW size 0x1000 flash, rw, executable, page 0x40
  0x1000 PROGMEM_RWW size 0x3000 flash, rw, executable, page 0x40

## Peripheral instances (address, pins/pin function, parameters)
AC0 at 0x0680 (AC)
  pins: AINN0 PD3/AINN; AINN1 PD0/AINN; AINN2 PD7/AINN; AINN3 PC2/AINN; AINP0 PD2/AINP; AINP3 PD6/AINP; AINP4 PC3/AINP; AINP5 PD4/AINP; AINP6 PD5/AINP; OUT PA7
  pin routing set by: PORTMUX.ACROUTEA.AC0
AC1 at 0x0688 (AC)
  pins: AINN0 PD5/AINN; AINN1 PD0/AINN; AINN2 PD7/AINN; AINN3 PC2/AINN; AINP0 PD2/AINP; AINP1 PD3/AINP; AINP2 PD4/AINP; AINP3 PD6/AINP; AINP4 PC3/AINP; AINP5 PA6/AINP; AINP6 PA7/AINP; OUT PA7
  pin routing set by: PORTMUX.ACROUTEA.AC1
ADC0 at 0x0600 (ADC)
  pins: AINN{n} PD{n}/AINN (n=0..7); AINN16 PF0/AINN; AINN17 PF1/AINN; AINN22 PA2/AINN; AINN23 PA3/AINN; AINN24 PA4/AINN; AINN25 PA5/AINN; AINN26 PA6/AINN; AINN27 PA7/AINN; AINN28 PC0/AINN; AINN29 PC1/AINN; AINN30 PC2/AINN; AINN31 PC3/AINN; AINP{n} PD{n}/AINP (n=0..7); AINP16 PF0/AINP; AINP17 PF1/AINP; AINP22 PA2/AINP; AINP23 PA3/AINP; AINP24 PA4/AINP; AINP25 PA5/AINP; AINP26 PA6/AINP; AINP27 PA7/AINP; AINP28 PC0/AINP; AINP29 PC1/AINP; AINP30 PC2/AINP; AINP31 PC3/AINP; VREFA PD7/VREF
BOD at 0x00A0
BOOTROW at 0x1100
CCL at 0x01C0
  pins: LUT0_IN0 PA0/IN; LUT0_IN1 PA1/IN; LUT0_IN2 PA2/IN; LUT1_IN0 PC0/IN; LUT1_IN1 PC1/IN; LUT1_IN2 PC2/IN; LUT2_IN0 PD0/IN; LUT2_IN1 PD1/IN; LUT2_IN2 PD2/IN; LUT3_IN0 PF0/IN; LUT3_IN1 PF1/IN; LUT0_OUT PA6/ALT1 or PA3; LUT1_OUT PC3; LUT2_OUT PD6/ALT1 or PD3
  pin routing set by: PORTMUX.CCLROUTEA.LUT0, PORTMUX.CCLROUTEA.LUT1, PORTMUX.CCLROUTEA.LUT2
CLKCTRL at 0x0060
  pins: EXTCLK PA0/EXTCLK; CLKOUT PA7/OUT; XTAL32K1 PA0/XTAL; XTAL32K2 PA1/XTAL
CPU at 0x0030
  parameters: CORE_VERSION=V4S
CPUINT at 0x0110
CRCSCAN at 0x0120
EVSYS at 0x0200
  pins: EVOUT0 PA7/ALT1 or PA2; EVOUT2 PC2; EVOUT3 PD7/ALT1 or PD2; EVOUT5 PF7/ALT1
  pin routing set by: PORTMUX.EVSYSROUTEA.EVOUTA, PORTMUX.EVSYSROUTEA.EVOUTC, PORTMUX.EVSYSROUTEA.EVOUTD, PORTMUX.EVSYSROUTEA.EVOUTF
FUSE at 0x1050
GPR at 0x001C
LOCK at 0x1040
NVMCTRL at 0x1000
PORTA at 0x0400 (PORT)
  pins: PIN{n} PA{n}/IOPORT (n=0..7)
PORTC at 0x0440 (PORT)
  pins: PIN0 PC0/IOPORT; PIN1 PC1/IOPORT; PIN2 PC2/IOPORT; PIN3 PC3/IOPORT
PORTD at 0x0460 (PORT)
  pins: PIN{n} PD{n}/IOPORT (n=0..7)
PORTF at 0x04A0 (PORT)
  pins: PIN0 PF0/IOPORT; PIN1 PF1/IOPORT; PIN6 PF6/IOPORT; PIN7 PF7/IOPORT
PORTMUX at 0x05E0
RSTCTRL at 0x0040
  pins: RESET PF6/OTHER
RTC at 0x0140
SIGROW at 0x1080
SLPCTRL at 0x0050
SPI0 at 0x0940 (SPI)
  pins: MISO PA1/ALT3 or PD5/ALT4 or PC1/ALT5 or PC2/ALT6 or PA5; MOSI PA0/ALT3 or PD4/ALT4 or PC0/ALT5 or PC1/ALT6 or PA4; SCK PC0/ALT3 or PD6/ALT4 or PC2/ALT5 or PC3/ALT6 or PA6; SS PC1/ALT3 or PD7/ALT4 or PC3/ALT5 or PF7/ALT6 or PA7
  pin routing set by: PORTMUX.SPIROUTEA.SPI0
SYSCFG at 0x0F00
TCB0 at 0x0B00 (TCB)
  pins: WO0 PA2
  pin routing set by: PORTMUX.TCBROUTEA.TCB0
TCB1 at 0x0B10 (TCB)
  pins: WO0 PA3
  pin routing set by: PORTMUX.TCBROUTEA.TCB1
TCE0 at 0x0A00 (TCE)
  pins: WO0 PC0/ALT2 or PD0/ALT3 or PF0/ALT5 or PA0/ALT8 or PA2/ALT9 or PA0; WO1 PC1/ALT2 or PD1/ALT3 or PF1/ALT5 or PA1/ALT8 or PA3/ALT9 or PA1; WO2 PC2/ALT2 or PD2/ALT3 or PC0/ALT8 or PA4/ALT9 or PA2; WO3 PC3/ALT2 or PD3/ALT3 or PC1/ALT8 or PA5/ALT9 or PA3; WO4 PD4/ALT3 or PC2/ALT8 or PA6/ALT9 or PA4; WO5 PD5/ALT3 or PC3/ALT8 or PA7/ALT9 or PA5; WO6 PD6/ALT3 or PA6; WO7 PD7/ALT3 or PA7
  pin routing set by: PORTMUX.TCEROUTEA.TCE0
TCF0 at 0x0C00 (TCF)
  pins: WO0 PA6/ALT1 or PA0; WO1 PA7/ALT1 or PA1
  pin routing set by: PORTMUX.TCFROUTEA.TCF0
TWI0 at 0x0900 (TWI)
  pins: SCL PA3/ALT1 or PC3/ALT2 or PA1/ALT3 or PA3; SDA PA2/ALT1 or PC2/ALT2 or PA0/ALT3 or PA2; SCL_DUAL PC3/ALT3 or PC3; SDA_DUAL PC2/ALT3 or PC2
  pin routing set by: PORTMUX.TWIROUTEA.TWI0
USART0 at 0x0800 (USART)
  pins: RXD PA5/ALT1 or PA3/ALT2 or PD5/ALT3 or PC2/ALT4 or PF6/ALT6 or PA1; TXD PA4/ALT1 or PA2/ALT2 or PD4/ALT3 or PC1/ALT4 or PF7/ALT6 or PA0; XCK PA6/ALT1 or PD6/ALT3 or PC3/ALT4 or PA2; XDIR PA7/ALT1 or PD7/ALT3 or PA3
  pin routing set by: PORTMUX.USARTROUTEA.USART0
USERROW at 0x1200
VPORTA at 0x0000 (VPORT)
VPORTC at 0x0008 (VPORT)
VPORTD at 0x000C (VPORT)
VPORTF at 0x0014 (VPORT)
VREF at 0x00B0
  pins: VREFA PD7
WDT at 0x0100
WEX0 at 0x0C80 (WEX)

## Interrupts
1 NMI (CRCSCAN)
2 VLM (BOD)
3 CNT (RTC)
4 PIT (RTC)
5 CCL
6 PORT (PORTA)
7 FAULT (WEX0)
8 OVF (TCE0)
9 CMP0 (TCE0)
10 CMP1 (TCE0)
11 CMP2 (TCE0)
12 CMP3 (TCE0)
13 INT (TCB0)
14 INT (TCB1)
15 TWIS (TWI0)
16 TWIM (TWI0)
17 INT (SPI0)
18 RXC (USART0)
19 DRE (USART0)
20 TXC (USART0)
21 PORT (PORTD)
22 INT (TCF0)
23 AC (AC0)
24 ERROR (ADC0)
25 RESRDY (ADC0)
26 SAMPRDY (ADC0)
27 AC (AC1)
28 PORT (PORTC)
29 PORT (PORTF)
30 EEREADY (NVMCTRL)
30 FLREADY (NVMCTRL)
30 NVMREADY (NVMCTRL)

## Properties
OCD_FEATURES: BREAK_PIN=PF6, BREAK_PIN_ALT1=PF2
SIGNATURES: SIGNATURE0=0x1E, SIGNATURE1=0x94, SIGNATURE2=0x3F

## Pinouts (pin number, pad)
QFN28: 1 PA3, 2 PA4, 3 PA5, 4 PA6, 5 PA7, 6 PC0, 7 PC1, 8 PC2, 9 PC3, 10 PD0, 11 PD1, 12 PD2, 13 PD3, 14 PD4, 15 PD5, 16 PD6, 17 PD7, 18 VDD, 19 GND, 20 PF0, 21 PF1, 22 PF6, 23 PF7, 24 VDD1, 25 GND1, 26 PA0, 27 PA1, 28 PA2
SOIC28: 1 PA7, 2 PC0, 3 PC1, 4 PC2, 5 PC3, 6 PD0, 7 PD1, 8 PD2, 9 PD3, 10 PD4, 11 PD5, 12 PD6, 13 PD7, 14 VDD, 15 GND, 16 PF0, 17 PF1, 18 PF6, 19 PF7, 20 VDD1, 21 GND1, 22 PA0, 23 PA1, 24 PA2, 25 PA3, 26 PA4, 27 PA5, 28 PA6
